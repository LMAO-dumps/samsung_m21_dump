/dts-v1/;

/ {
	compatible = "samsung, M21 SWA OPEN REV00", "samsung,EXYNOS9611";
	dtbo-hw_rev = <0x0>;
	dtbo-hw_rev_end = <0x5>;

	__fixups__ {
		abox = "/fragment@sound/__overlay__/sound:samsung,codec:0", "/fragment@sound/__overlay__/sound/rdma@0/cpu:sound-dai:0", "/fragment@sound/__overlay__/sound/rdma@1/cpu:sound-dai:0", "/fragment@sound/__overlay__/sound/rdma@2/cpu:sound-dai:0", "/fragment@sound/__overlay__/sound/rdma@3/cpu:sound-dai:0", "/fragment@sound/__overlay__/sound/rdma@4/cpu:sound-dai:0", "/fragment@sound/__overlay__/sound/rdma@5/cpu:sound-dai:0", "/fragment@sound/__overlay__/sound/rdma@6/cpu:sound-dai:0", "/fragment@sound/__overlay__/sound/rdma@7/cpu:sound-dai:0", "/fragment@sound/__overlay__/sound/wdma@0/cpu:sound-dai:0", "/fragment@sound/__overlay__/sound/wdma@1/cpu:sound-dai:0", "/fragment@sound/__overlay__/sound/wdma@2/cpu:sound-dai:0", "/fragment@sound/__overlay__/sound/wdma@3/cpu:sound-dai:0", "/fragment@sound/__overlay__/sound/wdma@4/cpu:sound-dai:0", "/fragment@sound/__overlay__/sound/sifs0@0/cpu:sound-dai:0", "/fragment@sound/__overlay__/sound/sifs1@0/cpu:sound-dai:0", "/fragment@sound/__overlay__/sound/sifs2@0/cpu:sound-dai:0", "/fragment@2:target:0";
		abox_bt = "/fragment@sound/__overlay__/sound:samsung,aux:4";
		abox_dsif = "/fragment@sound/__overlay__/sound:samsung,codec:20", "/fragment@sound/__overlay__/sound/dsif@0/cpu:sound-dai:0";
		abox_effect = "/fragment@sound/__overlay__/sound:samsung,aux:0";
		abox_rdma_0 = "/fragment@sound/__overlay__/sound/rdma@0/platform:sound-dai:0";
		abox_rdma_1 = "/fragment@sound/__overlay__/sound/rdma@1/platform:sound-dai:0";
		abox_rdma_2 = "/fragment@sound/__overlay__/sound/rdma@2/platform:sound-dai:0";
		abox_rdma_3 = "/fragment@sound/__overlay__/sound/rdma@3/platform:sound-dai:0";
		abox_rdma_4 = "/fragment@sound/__overlay__/sound/rdma@4/platform:sound-dai:0";
		abox_rdma_5 = "/fragment@sound/__overlay__/sound/rdma@5/platform:sound-dai:0";
		abox_rdma_6 = "/fragment@sound/__overlay__/sound/rdma@6/platform:sound-dai:0";
		abox_rdma_7 = "/fragment@sound/__overlay__/sound/rdma@7/platform:sound-dai:0";
		abox_spdy = "/fragment@sound/__overlay__/sound:samsung,codec:24", "/fragment@sound/__overlay__/sound/spdy@0/cpu:sound-dai:0";
		abox_synchronized_ipc = "/fragment@sound/__overlay__/sound/uaif@2/platform:sound-dai:0";
		abox_uaif_0 = "/fragment@sound/__overlay__/sound:samsung,codec:4", "/fragment@sound/__overlay__/sound/uaif@0/cpu:sound-dai:0";
		abox_uaif_1 = "/fragment@sound/__overlay__/sound:samsung,codec:8", "/fragment@sound/__overlay__/sound/uaif@1/cpu:sound-dai:0";
		abox_uaif_2 = "/fragment@sound/__overlay__/sound:samsung,codec:12", "/fragment@sound/__overlay__/sound/uaif@2/cpu:sound-dai:0";
		abox_uaif_4 = "/fragment@sound/__overlay__/sound:samsung,codec:16", "/fragment@sound/__overlay__/sound/uaif@4/cpu:sound-dai:0";
		abox_wdma_0 = "/fragment@sound/__overlay__/sound/wdma@0/platform:sound-dai:0";
		abox_wdma_1 = "/fragment@sound/__overlay__/sound/wdma@1/platform:sound-dai:0";
		abox_wdma_2 = "/fragment@sound/__overlay__/sound/wdma@2/platform:sound-dai:0";
		abox_wdma_3 = "/fragment@sound/__overlay__/sound/wdma@3/platform:sound-dai:0";
		abox_wdma_4 = "/fragment@sound/__overlay__/sound/wdma@4/platform:sound-dai:0";
		android_q_fstab = "/fragment@7:target:0";
		chosen = "/fragment@31:target:0";
		clock = "/fragment@sound/__overlay__/sound:clocks:0", "/fragment@34/__overlay__:clocks:0", "/fragment@34/__overlay__:clocks:8", "/fragment@37/__overlay__/sec-nfc@27:clocks:0";
		contexthub_0 = "/fragment@34:target:0";
		decon_f = "/fragment@1:target:0";
		dsim_0 = "/fragment@0:target:0";
		exynos_adc = "/fragment@battery/__overlay__/battery:io-channels:0", "/fragment@battery/__overlay__/battery:io-channels:8", "/fragment@battery/__overlay__/battery:io-channels:16", "/fragment@model/__overlay__/sec_thermistor@0:io-channels:0", "/fragment@model/__overlay__/sec_thermistor@6:io-channels:0";
		fimc_is = "/fragment@48:target:0";
		fimc_is_mclk0_fn = "/fragment@camera/__overlay__/fimc-fimc_is_module_gm2@5A:pinctrl-1:0", "/fragment@camera/__overlay__/fimc-is_sensor_gc5035@6E:pinctrl-2:0";
		fimc_is_mclk0_out = "/fragment@camera/__overlay__/fimc-fimc_is_module_gm2@5A:pinctrl-0:0", "/fragment@camera/__overlay__/fimc-is_sensor_gc5035@6E:pinctrl-1:0";
		fimc_is_mclk1_fn = "/fragment@camera/__overlay__/fimc-is_sensor_hi2021q@20:pinctrl-1:0";
		fimc_is_mclk1_out = "/fragment@camera/__overlay__/fimc-is_sensor_hi2021q@20:pinctrl-0:0";
		fimc_is_mclk2_fn = "/fragment@camera/__overlay__/fimc-is_sensor_4ha@5A:pinctrl-2:0";
		fimc_is_mclk2_out = "/fragment@camera/__overlay__/fimc-is_sensor_4ha@5A:pinctrl-1:0";
		fimc_is_sensor0 = "/fragment@56:target:0";
		fimc_is_sensor1 = "/fragment@57:target:0";
		fimc_is_sensor2 = "/fragment@58:target:0";
		fimc_is_sensor3 = "/fragment@59:target:0";
		fmp_0 = "/fragment@15:target:0";
		gnss_reserved = "/fragment@model/__overlay__/gnss_pdata:memory-region:0";
		gpa0 = "/fragment@lcd/__overlay__/decon_board_ea8076:gpio_pcd:0", "/fragment@lcd/__overlay__/decon_board_ea8076:gpio_con:0", "/fragment@model/__overlay__/i2c@13870000/mms_ts@48:melfas,irq-gpio:0", "/fragment@44/__overlay__/etspi-spi@0:etspi-drdyPin:0";
		gpa1 = "/fragment@lcd/__overlay__/decon_board_ea8076:gpio_err:0", "/fragment@4/__overlay__/rt5665@1b:interrupt-parent:0", "/fragment@model/__overlay__/gpio_keys/button@2:gpios:0", "/fragment@model/__overlay__/gpio_keys/button@3:gpios:0", "/fragment@model/__overlay__/gpio_keys/button@4:gpios:0", "/fragment@37/__overlay__/sec-nfc@27:interrupt-parent:0", "/fragment@37/__overlay__/sec-nfc@27:sec-nfc,irq-gpio:0", "/fragment@camera/__overlay__/fimc-is-flash-gpio@0:torch-gpio:0", "/fragment@55/__overlay__/sm5713-fled@49/sm5713-fled@0:torch-en-gpio:0";
		gpa2 = "/fragment@model/__overlay__/speedy@11a10000/s2mpu09mfd@00:s2mpu09,irq-gpio:0", "/fragment@model/__overlay__/speedy@11a10000/s2mpu09mfd@00:interrupt-parent:0", "/fragment@model/__overlay__/dwmmc2@13550000:card-detect:0", "/fragment@model/__overlay__/i2c@20/a96t3x6@20:interrupt-parent:0", "/fragment@model/__overlay__/i2c@20/a96t3x6@20:a96t3x6,irq_gpio:0", "/fragment@37/__overlay__/sec-nfc@27:sec-nfc,clk_req-gpio:0", "/fragment@46/__overlay__/usbpd-5713@33:usbpd,usbpd_int:0", "/fragment@47/__overlay__/sm5713@49:sm5713,irq-gpio:0", "/fragment@motor/__overlay__/dc_vibrator:dc_vib,gpio_en:0";
		gpc0 = "/fragment@49/__overlay__:gpios:0", "/fragment@49/__overlay__:gpios:12", "/fragment@50/__overlay__:gpios:0", "/fragment@50/__overlay__:gpios:12", "/fragment@51/__overlay__:gpios:0", "/fragment@51/__overlay__:gpios:12", "/fragment@52/__overlay__:gpios:0", "/fragment@52/__overlay__:gpios:12";
		gpc1 = "/fragment@53/__overlay__:gpios:0", "/fragment@53/__overlay__:gpios:12", "/fragment@54/__overlay__:gpios:0", "/fragment@54/__overlay__:gpios:12";
		gpc2 = "/fragment@camera/__overlay__/fimc-fimc_is_module_gm2@5A:gpio_mclk:0", "/fragment@camera/__overlay__/fimc-is_sensor_gc5035@6E:gpio_mclk:0", "/fragment@camera/__overlay__/fimc-is_sensor_4ha@5A:gpio_mclk:0", "/fragment@camera/__overlay__/fimc-is_sensor_hi2021q@20:gpio_mclk:0";
		gpg0 = "/fragment@37/__overlay__/sec-nfc@27:sec-nfc,ven-gpio:0", "/fragment@37/__overlay__/sec-nfc@27:sec-nfc,check_nfc:0", "/fragment@camera/__overlay__/fimc-is-flash-gpio@0:flash-gpio:0", "/fragment@camera/__overlay__/fimc-is_sensor_gc5035@6E:gpio_reset:0", "/fragment@55/__overlay__/sm5713-fled@49/sm5713-fled@0:flash-en-gpio:0";
		gpg1 = "/fragment@lcd/__overlay__/decon_board_ea8076:gpio_lcd_rst:0", "/fragment@lcd/__overlay__/decon_board_ea8076:gpio_lcd_en_1p8:0", "/fragment@37/__overlay__/sec-nfc@27:sec-nfc,firm-gpio:0", "/fragment@camera/__overlay__/fimc-fimc_is_module_gm2@5A:gpio_reset:0", "/fragment@camera/__overlay__/fimc-is_sensor_4ha@5A:gpio_reset:0", "/fragment@camera/__overlay__/fimc-is_sensor_4ha@5A:gpio_cam_a2p8_en:0", "/fragment@camera/__overlay__/fimc-is_sensor_hi2021q@20:gpio_reset:0";
		gpg2 = "/fragment@lcd/__overlay__/decon_board_ea8076:gpio_lcd_en_3p0:0", "/fragment@model/__overlay__/i2c@20/a96t3x6@20:a96t3x6,ldo_en:0", "/fragment@37/__overlay__/sec-nfc@27:sec-nfc,pvdd_en:0", "/fragment@44/__overlay__/etspi-spi@0:etspi-ldoPin:0";
		gpg3 = "/fragment@model/__overlay__/mif_pdata:gpios:0", "/fragment@model/__overlay__/mif_pdata:gpios:12", "/fragment@model/__overlay__/mif_pdata:gpios:24", "/fragment@model/__overlay__/mif_pdata:gpios:36", "/fragment@model/__overlay__/tsp_ldo_en:gpio:0", "/fragment@44/__overlay__/etspi-spi@0:etspi-sleepPin:0";
		gpm21 = "/fragment@34/__overlay__:sensor-ldo-en:0";
		gpp1 = "/fragment@model/__overlay__/i2c@13870000/mms_ts@48:melfas,scl-gpio:0", "/fragment@model/__overlay__/i2c@13870000/mms_ts@48:melfas,sda-gpio:0", "/fragment@model/__overlay__/i2c@20:gpios:0", "/fragment@model/__overlay__/i2c@20:gpios:12";
		gpp2 = "/fragment@44/__overlay__/etspi-spi@0/controller-data:cs-gpio:0";
		hsi2c12_bus = "/fragment@49/__overlay__:pinctrl-0:0", "/fragment@49/__overlay__:pinctrl-1:0", "/fragment@49/__overlay__:pinctrl-2:0";
		hsi2c13_bus = "/fragment@50/__overlay__:pinctrl-0:0", "/fragment@50/__overlay__:pinctrl-1:0", "/fragment@50/__overlay__:pinctrl-2:0";
		hsi2c14_bus = "/fragment@51/__overlay__:pinctrl-0:0", "/fragment@51/__overlay__:pinctrl-1:0", "/fragment@51/__overlay__:pinctrl-2:0";
		hsi2c15_bus = "/fragment@52/__overlay__:pinctrl-0:0", "/fragment@52/__overlay__:pinctrl-1:0", "/fragment@52/__overlay__:pinctrl-2:0";
		hsi2c16_bus = "/fragment@53/__overlay__:pinctrl-0:0", "/fragment@53/__overlay__:pinctrl-1:0", "/fragment@53/__overlay__:pinctrl-2:0";
		hsi2c17_bus = "/fragment@54/__overlay__:pinctrl-0:0", "/fragment@54/__overlay__:pinctrl-1:0", "/fragment@54/__overlay__:pinctrl-2:0";
		hsi2c_12 = "/fragment@49:target:0";
		hsi2c_13 = "/fragment@50:target:0";
		hsi2c_14 = "/fragment@51:target:0";
		hsi2c_15 = "/fragment@52:target:0";
		hsi2c_16 = "/fragment@53:target:0";
		hsi2c_17 = "/fragment@54:target:0";
		hsi2c_3 = "/fragment@3:target:0";
		hsi2c_6 = "/fragment@37:target:0";
		i2c_0 = "/fragment@46:target:0";
		i2c_1 = "/fragment@47:target:0", "/fragment@55:target:0";
		i2c_3 = "/fragment@32:target:0";
		i2c_6 = "/fragment@4:target:0";
		mipi_phy_csis_m2s4s4s2 = "/fragment@57/__overlay__:phys:0", "/fragment@59/__overlay__:phys:0";
		pdma0 = "/fragment@44/__overlay__:dmas:0", "/fragment@44/__overlay__:dmas:8";
		pinctrl_0 = "/fragment@13:target:0", "/fragment@35:target:0", "/fragment@38:target:0", "/fragment@42:target:0", "/fragment@45:target:0", "/fragment@60:target:0";
		pinctrl_1 = "/fragment@39:target:0";
		pinctrl_2 = "/fragment@40:target:0";
		pinctrl_4 = "/fragment@5:target:0", "/fragment@14:target:0", "/fragment@36:target:0", "/fragment@41:target:0", "/fragment@43:target:0", "/fragment@61:target:0";
		reserved_memory = "/fragment@33:target:0";
		sd2_bus1 = "/fragment@model/__overlay__/dwmmc2@13550000:pinctrl-0:8";
		sd2_bus4 = "/fragment@model/__overlay__/dwmmc2@13550000:pinctrl-0:12";
		sd2_clk = "/fragment@model/__overlay__/dwmmc2@13550000:pinctrl-0:0";
		sd2_clk_fast_slew_rate_1x = "/fragment@model/__overlay__/dwmmc2@13550000:pinctrl-1:0";
		sd2_clk_fast_slew_rate_2x = "/fragment@model/__overlay__/dwmmc2@13550000:pinctrl-2:0";
		sd2_clk_fast_slew_rate_3x = "/fragment@model/__overlay__/dwmmc2@13550000:pinctrl-3:0";
		sd2_clk_fast_slew_rate_4x = "/fragment@model/__overlay__/dwmmc2@13550000:pinctrl-4:0";
		sd2_cmd = "/fragment@model/__overlay__/dwmmc2@13550000:pinctrl-0:4";
		serial_0 = "/fragment@12:target:0";
		shared_meta = "/fragment@6:target:0";
		spi_7 = "/fragment@44:target:0";
		udc = "/fragment@model/__overlay__/usb_notifier:udc:0", "/fragment@8:target:0";
		usbdrd3_phy = "/fragment@11:target:0";
		usbdrd_dwc3 = "/fragment@9:target:0";
		usbdrd_phy = "/fragment@10:target:0";
		usi_0_cmgp = "/fragment@18:target:0";
		usi_0_cmgp_i2c = "/fragment@19:target:0";
		usi_0_shub = "/fragment@16:target:0";
		usi_0_shub_i2c = "/fragment@17:target:0";
		usi_1_cmgp = "/fragment@20:target:0";
		usi_1_cmgp_i2c = "/fragment@21:target:0";
		usi_2_cmgp = "/fragment@22:target:0";
		usi_2_cmgp_i2c = "/fragment@23:target:0";
		usi_3_cmgp = "/fragment@24:target:0";
		usi_3_cmgp_i2c = "/fragment@25:target:0";
		usi_4_cmgp = "/fragment@26:target:0";
		usi_4_cmgp_i2c = "/fragment@27:target:0";
		usi_peri_spi_1 = "/fragment@30:target:0";
		usi_peri_usi_0 = "/fragment@28:target:0";
		usi_peri_usi_0_i2c = "/fragment@29:target:0";
		xclkout0 = "/fragment@sound/__overlay__/sound:pinctrl-0:0";
		xclkout1 = "/fragment@37/__overlay__/sec-nfc@27:pinctrl-0:12";
	};

	__local_fixups__ {

		fragment@0 {

			__overlay__ {
				lcd_info = <0x0>;
			};
		};

		fragment@10 {

			__overlay__ {
				hs_tune_param = <0x0>;
			};
		};

		fragment@11 {

			__overlay__ {
				hs_tune_param = <0x0>;
				ss_tune_param = <0x0>;
			};
		};

		fragment@37 {

			__overlay__ {

				sec-nfc@27 {
					pinctrl-0 = <0x0 0x4 0x8 0x10 0x14>;
					pinctrl-1 = <0x0 0x4 0x8 0xc 0x10>;
				};
			};
		};

		fragment@38 {

			__overlay__ {
				pinctrl-0 = <0x0>;
			};
		};

		fragment@39 {

			__overlay__ {
				pinctrl-0 = <0x0>;
				pinctrl-1 = <0x0>;
			};
		};

		fragment@4 {

			__overlay__ {

				rt5665@1b {
					pinctrl-0 = <0x0>;
					realtek,regulator_1v8 = <0x0>;
					realtek,regulator_3v3 = <0x0>;
				};
			};
		};

		fragment@40 {

			__overlay__ {
				pinctrl-0 = <0x0>;
			};
		};

		fragment@41 {

			__overlay__ {
				pinctrl-0 = <0x0>;
				pinctrl-1 = <0x0>;
			};
		};

		fragment@44 {

			__overlay__ {

				etspi-spi@0 {
					pinctrl-0 = <0x0 0x4 0x8>;
					pinctrl-1 = <0x0 0x4 0x8 0xc 0x10>;
					pinctrl-2 = <0x0 0x4 0x8>;
					pinctrl-3 = <0x0>;
					pinctrl-4 = <0x0>;
				};
			};
		};

		fragment@46 {

			__overlay__ {

				usbpd-5713@33 {
					pinctrl-0 = <0x0>;
				};
			};
		};

		fragment@47 {

			__overlay__ {

				sm5713@49 {
					pinctrl-0 = <0x0 0x4>;
				};
			};
		};

		fragment@lcd {

			__overlay__ {

				ea8076 {
					decon_board = <0x0>;
				};
			};
		};

		fragment@model {

			__overlay__ {

				dwmmc2@13550000 {
					pinctrl-0 = <0x10>;
				};

				gnss_pdata {
					mbox_info = <0x0>;
				};

				gpio_keys {
					pinctrl-0 = <0x0 0x4 0x8>;
				};

				i2c@13870000 {

					mms_ts@48 {
						pinctrl-0 = <0x0>;
						pinctrl-1 = <0x0>;
					};
				};

				i2c@20 {
					pinctrl-0 = <0x0>;
					pinctrl-1 = <0x0>;
					pinctrl-2 = <0x0>;

					a96t3x6@20 {
						pinctrl-0 = <0x0 0x4>;
					};
				};

				speedy@11a10000 {

					s2mpu09mfd@00 {
						pinctrl-0 = <0x0 0x4>;
					};
				};
			};
		};

		fragment@motor {

			__overlay__ {

				dc_vibrator {
					pinctrl-0 = <0x0>;
				};
			};
		};

		fragment@sound {

			__overlay__ {

				sound {

					dsif@0 {

						codec {
							sound-dai = <0x0>;
						};
					};

					rdma@0 {

						codec {
							sound-dai = <0x0>;
						};
					};

					rdma@1 {

						codec {
							sound-dai = <0x0>;
						};
					};

					rdma@2 {

						codec {
							sound-dai = <0x0>;
						};
					};

					rdma@3 {

						codec {
							sound-dai = <0x0>;
						};
					};

					rdma@4 {

						codec {
							sound-dai = <0x0>;
						};
					};

					rdma@5 {

						codec {
							sound-dai = <0x0>;
						};
					};

					rdma@6 {

						codec {
							sound-dai = <0x0>;
						};
					};

					rdma@7 {

						codec {
							sound-dai = <0x0>;
						};
					};

					sifs0@0 {

						codec {
							sound-dai = <0x0>;
						};
					};

					sifs1@0 {

						codec {
							sound-dai = <0x0>;
						};
					};

					sifs2@0 {

						codec {
							sound-dai = <0x0>;
						};
					};

					spdy@0 {

						codec {
							sound-dai = <0x0>;
						};
					};

					uaif@0 {

						codec {
							sound-dai = <0x0>;
						};
					};

					uaif@1 {

						codec {
							sound-dai = <0x0>;
						};
					};

					uaif@2 {

						codec {
							sound-dai = <0x0>;
						};
					};

					uaif@4 {

						codec {
							sound-dai = <0x0>;
						};
					};

					wdma@0 {

						codec {
							sound-dai = <0x0>;
						};
					};

					wdma@1 {

						codec {
							sound-dai = <0x0>;
						};
					};

					wdma@2 {

						codec {
							sound-dai = <0x0>;
						};
					};

					wdma@3 {

						codec {
							sound-dai = <0x0>;
						};
					};

					wdma@4 {

						codec {
							sound-dai = <0x0>;
						};
					};
				};
			};
		};
	};

	__symbols__ {
		V_SYS = "/fragment@model/__overlay__/fixedregulator@1";
		__ldo1_reg = "/fragment@32/__overlay__/s2mpb03@56/regulators/s2mpb03-ldo1";
		__ldo2_reg = "/fragment@32/__overlay__/s2mpb03@56/regulators/s2mpb03-ldo2";
		__ldo3_reg = "/fragment@32/__overlay__/s2mpb03@56/regulators/s2mpb03-ldo3";
		__ldo4_reg = "/fragment@32/__overlay__/s2mpb03@56/regulators/s2mpb03-ldo4";
		__ldo5_reg = "/fragment@32/__overlay__/s2mpb03@56/regulators/s2mpb03-ldo5";
		__ldo6_reg = "/fragment@32/__overlay__/s2mpb03@56/regulators/s2mpb03-ldo6";
		__ldo7_reg = "/fragment@32/__overlay__/s2mpb03@56/regulators/s2mpb03-ldo7";
		attn_input = "/fragment@13/__overlay__/attn-input";
		attn_irq = "/fragment@13/__overlay__/attn-irq";
		b1_reg = "/fragment@model/__overlay__/speedy@11a10000/s2mpu09mfd@00/regulators/BUCK1";
		b2_reg = "/fragment@model/__overlay__/speedy@11a10000/s2mpu09mfd@00/regulators/BUCK2";
		b3_reg = "/fragment@model/__overlay__/speedy@11a10000/s2mpu09mfd@00/regulators/BUCK3";
		b4_reg = "/fragment@model/__overlay__/speedy@11a10000/s2mpu09mfd@00/regulators/BUCK4";
		b5_reg = "/fragment@model/__overlay__/speedy@11a10000/s2mpu09mfd@00/regulators/BUCK5";
		b6_reg = "/fragment@model/__overlay__/speedy@11a10000/s2mpu09mfd@00/regulators/BUCK6";
		b7_reg = "/fragment@model/__overlay__/speedy@11a10000/s2mpu09mfd@00/regulators/BUCK7";
		b8_reg = "/fragment@model/__overlay__/speedy@11a10000/s2mpu09mfd@00/regulators/BUCK8";
		b9_reg = "/fragment@model/__overlay__/speedy@11a10000/s2mpu09mfd@00/regulators/BUCK9";
		btp_irq = "/fragment@42/__overlay__/btp-irq";
		btp_irq_sleep = "/fragment@42/__overlay__/btp-irq-sleep";
		btp_ldo = "/fragment@43/__overlay__/btp-ldo";
		btp_rst = "/fragment@43/__overlay__/btp-rst";
		chg_en = "/fragment@5/__overlay__/chg-en";
		codec_irq = "/fragment@13/__overlay__/codec_irq";
		decon_board_ea8076 = "/fragment@lcd/__overlay__/decon_board_ea8076";
		dummy_audio_codec = "/fragment@sound/__overlay__/audio_codec_dummy";
		dummy_audio_cpu = "/fragment@sound/__overlay__/audio_cpu_dummy";
		dwmmc2_cd_ext_irq = "/fragment@13/__overlay__/dwmmc2_cd_ext_irq";
		ea8076 = "/fragment@lcd/__overlay__/ea8076";
		ext_bin_0 = "/fragment@2/__overlay__/ext_bin@0";
		ext_bin_1 = "/fragment@2/__overlay__/ext_bin@1";
		ext_bin_2 = "/fragment@2/__overlay__/ext_bin@2";
		ext_bin_4 = "/fragment@2/__overlay__/ext_bin@4";
		ext_bin_5 = "/fragment@2/__overlay__/ext_bin@5";
		fimc_is_flash_gpio = "/fragment@camera/__overlay__/fimc-is-flash-gpio@0";
		fimc_is_module_gc5035 = "/fragment@camera/__overlay__/fimc-is_sensor_gc5035@6E";
		fimc_is_module_gm2 = "/fragment@camera/__overlay__/fimc-fimc_is_module_gm2@5A";
		fimc_is_sensor_4ha = "/fragment@camera/__overlay__/fimc-is_sensor_4ha@5A";
		fimc_is_sensor_hi2021q = "/fragment@camera/__overlay__/fimc-is_sensor_hi2021q@20";
		grip_gpio = "/fragment@61/__overlay__/grip-gpio";
		grip_i2c = "/fragment@61/__overlay__/grip-i2c";
		grip_int = "/fragment@60/__overlay__/grip-int";
		grip_ldo = "/fragment@14/__overlay__/grip-ldo";
		i2c_4 = "/fragment@model/__overlay__/i2c@13870000";
		if_pmic_irq = "/fragment@45/__overlay__/if-pmic-irq";
		initial0 = "/fragment@38/__overlay__/initial-state";
		initial1 = "/fragment@39/__overlay__/initial-state";
		initial4 = "/fragment@41/__overlay__/initial-state";
		key_power = "/fragment@13/__overlay__/key-power";
		key_voldown = "/fragment@13/__overlay__/key-voldown";
		key_volup = "/fragment@13/__overlay__/key-volup";
		l10_reg = "/fragment@model/__overlay__/speedy@11a10000/s2mpu09mfd@00/regulators/LDO10";
		l11_reg = "/fragment@model/__overlay__/speedy@11a10000/s2mpu09mfd@00/regulators/LDO11";
		l12_reg = "/fragment@model/__overlay__/speedy@11a10000/s2mpu09mfd@00/regulators/LDO12";
		l13_reg = "/fragment@model/__overlay__/speedy@11a10000/s2mpu09mfd@00/regulators/LDO13";
		l14_reg = "/fragment@model/__overlay__/speedy@11a10000/s2mpu09mfd@00/regulators/LDO14";
		l1_reg = "/fragment@model/__overlay__/speedy@11a10000/s2mpu09mfd@00/regulators/LDO1";
		l2_reg = "/fragment@model/__overlay__/speedy@11a10000/s2mpu09mfd@00/regulators/LDO2";
		l33_reg = "/fragment@model/__overlay__/speedy@11a10000/s2mpu09mfd@00/regulators/LDO33";
		l34_reg = "/fragment@model/__overlay__/speedy@11a10000/s2mpu09mfd@00/regulators/LDO34";
		l35_reg = "/fragment@model/__overlay__/speedy@11a10000/s2mpu09mfd@00/regulators/LDO35";
		l36_reg = "/fragment@model/__overlay__/speedy@11a10000/s2mpu09mfd@00/regulators/LDO36";
		l37_reg = "/fragment@model/__overlay__/speedy@11a10000/s2mpu09mfd@00/regulators/LDO37";
		l38_reg = "/fragment@model/__overlay__/speedy@11a10000/s2mpu09mfd@00/regulators/LDO38";
		l39_reg = "/fragment@model/__overlay__/speedy@11a10000/s2mpu09mfd@00/regulators/LDO39";
		l3_reg = "/fragment@model/__overlay__/speedy@11a10000/s2mpu09mfd@00/regulators/LDO3";
		l40_reg = "/fragment@model/__overlay__/speedy@11a10000/s2mpu09mfd@00/regulators/LDO40";
		l41_reg = "/fragment@model/__overlay__/speedy@11a10000/s2mpu09mfd@00/regulators/LDO41";
		l42_reg = "/fragment@model/__overlay__/speedy@11a10000/s2mpu09mfd@00/regulators/LDO42";
		l43_reg = "/fragment@model/__overlay__/speedy@11a10000/s2mpu09mfd@00/regulators/LDO43";
		l44_reg = "/fragment@model/__overlay__/speedy@11a10000/s2mpu09mfd@00/regulators/LDO44";
		l4_reg = "/fragment@model/__overlay__/speedy@11a10000/s2mpu09mfd@00/regulators/LDO4";
		l5_reg = "/fragment@model/__overlay__/speedy@11a10000/s2mpu09mfd@00/regulators/LDO5";
		l6_reg = "/fragment@model/__overlay__/speedy@11a10000/s2mpu09mfd@00/regulators/LDO6";
		l7_reg = "/fragment@model/__overlay__/speedy@11a10000/s2mpu09mfd@00/regulators/LDO7";
		l8_reg = "/fragment@model/__overlay__/speedy@11a10000/s2mpu09mfd@00/regulators/LDO8";
		l9_reg = "/fragment@model/__overlay__/speedy@11a10000/s2mpu09mfd@00/regulators/LDO9";
		mailbox_cp = "/fragment@model/__overlay__/mcu_ipc@11920000";
		mailbox_gnss = "/fragment@model/__overlay__/mcu_ipc@11A00000";
		motor_en = "/fragment@13/__overlay__/motor-en";
		nfc_check = "/fragment@36/__overlay__/nfc-check";
		nfc_clk_req = "/fragment@35/__overlay__/nfc_clk_req";
		nfc_clk_req_nc = "/fragment@35/__overlay__/nfc_clk_req_nc";
		nfc_en = "/fragment@36/__overlay__/nfc_en";
		nfc_en_nc = "/fragment@36/__overlay__/nfc_en_nc";
		nfc_firm = "/fragment@36/__overlay__/nfc_firm";
		nfc_firm_nc = "/fragment@36/__overlay__/nfc_firm_nc";
		nfc_pwr_en = "/fragment@36/__overlay__/nfc_pwr_en";
		nfc_pwr_en_nc = "/fragment@36/__overlay__/nfc_pwr_en_nc";
		pm_wrsti = "/fragment@14/__overlay__/pm-wrsti";
		pmic_irq = "/fragment@13/__overlay__/pmic-irq";
		rt5510_amp = "/fragment@3/__overlay__/rt5510@34";
		rt5665 = "/fragment@4/__overlay__/rt5665@1b";
		sensor3_ch_mode0 = "/fragment@59/__overlay__/sensor3-ch-mode0";
		shmem = "/fragment@modemif/__overlay__/shmem@F0000000";
		sleep1 = "/fragment@39/__overlay__/sleep-state";
		sleep2 = "/fragment@40/__overlay__/sleep-state";
		sleep4 = "/fragment@41/__overlay__/sleep-state";
		spi7_bus_inactive = "/fragment@43/__overlay__/spi7-bus-inactive";
		spi7_clk = "/fragment@43/__overlay__/spi7-clk";
		spi7_cs = "/fragment@43/__overlay__/spi7-cs";
		spi7_miso = "/fragment@43/__overlay__/spi7-miso";
		spi7_miso_inactive = "/fragment@43/__overlay__/spi17-miso-inactive";
		spi7_mosi = "/fragment@43/__overlay__/spi7-mosi";
		usb3_hs_tune = "/fragment@model/__overlay__/usb3_hs_tune";
		usb3_ss_tune = "/fragment@model/__overlay__/usb3_ss_tune";
		usb_hs_tune = "/fragment@model/__overlay__/usb_hs_tune";
		usbpd_irq = "/fragment@45/__overlay__/usbpd-irq";
		xclkout1_nc = "/fragment@35/__overlay__/xclkout1_nc";
	};

	fragment@0 {
		target = <0xffffffff>;

		__overlay__ {
			lcd_info = <0x2>;
		};
	};

	fragment@1 {
		target = <0xffffffff>;

		__overlay__ {
			dsi_mode = <0x0>;
			psr_mode = <0x2>;
			trig_mode = <0x0>;
		};
	};

	fragment@10 {
		target = <0xffffffff>;

		__overlay__ {
			hs_tune_param = <0x16>;
			status = "okay";
			usb3phy-isolation = <0x1>;
		};
	};

	fragment@11 {
		target = <0xffffffff>;

		__overlay__ {
			hs_tune_param = <0x17>;
			ss_tune_param = <0x18>;
			status = "okay";
			usb3phy-isolation = <0x1>;
		};
	};

	fragment@12 {
		target = <0xffffffff>;

		__overlay__ {
			samsung,uart-logging;
			status = "okay";
		};
	};

	fragment@13 {
		target = <0xffffffff>;

		__overlay__ {

			attn-input {
				linux,phandle = <0x10>;
				phandle = <0x10>;
				samsung,pin-function = <0x0>;
				samsung,pin-pud = <0x1>;
				samsung,pins = "gpa0-0";
			};

			attn-irq {
				linux,phandle = <0xf>;
				phandle = <0xf>;
				samsung,pin-drv = <0x0>;
				samsung,pin-function = <0xf>;
				samsung,pin-pud = <0x0>;
				samsung,pins = "gpa0-0";
			};

			codec_irq {
				linux,phandle = <0x6>;
				phandle = <0x6>;
				samsung,pin-function = <0xf>;
				samsung,pin-pud = <0x0>;
				samsung,pins = "gpa1-2";
			};

			dwmmc2_cd_ext_irq {
				linux,phandle = <0x11>;
				phandle = <0x11>;
				samsung,pin-drv = <0x3>;
				samsung,pin-function = <0xf>;
				samsung,pin-pud = <0x0>;
				samsung,pins = "gpa2-4";
			};

			key-power {
				linux,phandle = <0xe>;
				phandle = <0xe>;
				samsung,pin-drv = <0x0>;
				samsung,pin-function = <0xf>;
				samsung,pin-pud = <0x0>;
				samsung,pins = "gpa1-7";
			};

			key-voldown {
				linux,phandle = <0xc>;
				phandle = <0xc>;
				samsung,pin-drv = <0x0>;
				samsung,pin-function = <0xf>;
				samsung,pin-pud = <0x0>;
				samsung,pins = "gpa1-6";
			};

			key-volup {
				linux,phandle = <0xd>;
				phandle = <0xd>;
				samsung,pin-drv = <0x0>;
				samsung,pin-function = <0xf>;
				samsung,pin-pud = <0x0>;
				samsung,pins = "gpa1-5";
			};

			motor-en {
				linux,phandle = <0x36>;
				phandle = <0x36>;
				samsung,pin-con-pdn = <0x3>;
				samsung,pin-function = <0x1>;
				samsung,pin-pud = <0x0>;
				samsung,pin-pud-pdn = <0x0>;
				samsung,pin-val = <0x0>;
				samsung,pins = "gpa2-1";
			};

			pmic-irq {
				linux,phandle = <0x9>;
				phandle = <0x9>;
				samsung,pin-drv = <0x3>;
				samsung,pin-pud = <0x3>;
				samsung,pins = "gpa2-0";
			};
		};
	};

	fragment@14 {
		target = <0xffffffff>;

		__overlay__ {

			grip-ldo {
				linux,phandle = <0x15>;
				phandle = <0x15>;
				samsung,pin-function = <0x1>;
				samsung,pin-pud = <0x0>;
				samsung,pins = "gpg2-1";
			};

			pm-wrsti {
				linux,phandle = <0xa>;
				phandle = <0xa>;
				samsung,pin-con-pdn = <0x3>;
				samsung,pins = "gpg0-7";
			};
		};
	};

	fragment@15 {
		target = <0xffffffff>;

		__overlay__ {
			exynos,block-type = "sda";
			exynos,fips-block_offset = <0x5>;
		};
	};

	fragment@16 {
		target = <0xffffffff>;

		__overlay__ {
			status = "disabled";
		};
	};

	fragment@17 {
		target = <0xffffffff>;

		__overlay__ {
			status = "disabled";
		};
	};

	fragment@18 {
		target = <0xffffffff>;

		__overlay__ {
			status = "okay";
			usi_v2_mode = "spi";
		};
	};

	fragment@19 {
		target = <0xffffffff>;

		__overlay__ {
			status = "disabled";
		};
	};

	fragment@2 {
		target = <0xffffffff>;

		__overlay__ {

			ext_bin@0 {
				linux,phandle = <0x39>;
				phandle = <0x39>;
				samsung,area = <0x1>;
				samsung,name = "rtdsp.bin";
				samsung,offset = <0x502000>;
				status = "okay";
			};

			ext_bin@1 {
				linux,phandle = <0x3a>;
				phandle = <0x3a>;
				samsung,area = <0x1>;
				samsung,name = "AP_AUDIO_SLSI.bin";
				samsung,offset = <0x7f0000>;
				status = "okay";
			};

			ext_bin@2 {
				linux,phandle = <0x3b>;
				phandle = <0x3b>;
				samsung,area = <0x1>;
				samsung,name = "APBargeIn_AUDIO_SLSI.bin";
				samsung,offset = <0x7ec000>;
				status = "okay";
			};

			ext_bin@4 {
				linux,phandle = <0x3c>;
				phandle = <0x3c>;
				samsung,area = <0x1>;
				samsung,name = "rtdsp_param.bin";
				samsung,offset = <0x582000>;
				status = "okay";
			};

			ext_bin@5 {
				linux,phandle = <0x3d>;
				phandle = <0x3d>;
				samsung,area = <0x1>;
				samsung,name = "APBiBF_AUDIO_SLSI.bin";
				samsung,offset = <0x7ef000>;
				status = "okay";
			};
		};
	};

	fragment@20 {
		target = <0xffffffff>;

		__overlay__ {
			status = "disabled";
		};
	};

	fragment@21 {
		target = <0xffffffff>;

		__overlay__ {
			status = "okay";
			usi_v2_mode = "i2c";
		};
	};

	fragment@22 {
		target = <0xffffffff>;

		__overlay__ {
			status = "okay";
			usi_v2_mode = "i2c";
		};
	};

	fragment@23 {
		target = <0xffffffff>;

		__overlay__ {
			status = "disabled";
		};
	};

	fragment@24 {
		target = <0xffffffff>;

		__overlay__ {
			status = "okay";
			usi_v2_mode = "i2c";
		};
	};

	fragment@25 {
		target = <0xffffffff>;

		__overlay__ {
			status = "disabled";
		};
	};

	fragment@26 {
		target = <0xffffffff>;

		__overlay__ {
			status = "okay";
			usi_v2_mode = "spi";
		};
	};

	fragment@27 {
		target = <0xffffffff>;

		__overlay__ {
			status = "disabled";
		};
	};

	fragment@28 {
		target = <0xffffffff>;

		__overlay__ {
			status = "okay";
			usi_v2_mode = "i2c";
		};
	};

	fragment@29 {
		target = <0xffffffff>;

		__overlay__ {
			status = "disabled";
		};
	};

	fragment@3 {
		target = <0xffffffff>;

		__overlay__ {
			#address-cells = <0x1>;
			#size-cells = <0x0>;
			status = "okay";

			rt5510@34 {
				#sound-dai-cells = <0x1>;
				compatible = "richtek,rt5510";
				linux,phandle = <0x5>;
				phandle = <0x5>;
				reg = <0x34>;
				status = "okay";
			};
		};
	};

	fragment@30 {
		target = <0xffffffff>;

		__overlay__ {
			status = "okay";
			usi_v2_mode = "spi";
		};
	};

	fragment@31 {
		target = <0xffffffff>;

		__overlay__ {
			bootargs_ext = "root=/dev/ram0 androidboot.boot_devices=13520000.ufs";
		};
	};

	fragment@32 {
		target = <0xffffffff>;

		__overlay__ {
			#address-cells = <0x1>;
			#size-cells = <0x0>;
			status = "okay";

			s2mpb03@56 {
				compatible = "samsung,s2mpb03pmic";
				reg = <0x56>;
				s2mpb03,wakeup;

				regulators {

					s2mpb03-ldo1 {
						linux,phandle = <0x62>;
						phandle = <0x62>;
						regulator-max-microvolt = <0x100590>;
						regulator-min-microvolt = <0x100590>;
						regulator-name = "CAM_VLDO1";
					};

					s2mpb03-ldo2 {
						linux,phandle = <0x63>;
						phandle = <0x63>;
						regulator-max-microvolt = <0x10c8e0>;
						regulator-min-microvolt = <0x10c8e0>;
						regulator-name = "CAM_VLDO2";
					};

					s2mpb03-ldo3 {
						linux,phandle = <0x64>;
						phandle = <0x64>;
						regulator-max-microvolt = <0x1b7740>;
						regulator-min-microvolt = <0x1b7740>;
						regulator-name = "CAM_VLDO3";
					};

					s2mpb03-ldo4 {
						linux,phandle = <0x65>;
						phandle = <0x65>;
						regulator-max-microvolt = <0x124f80>;
						regulator-min-microvolt = <0x124f80>;
						regulator-name = "CAM_VLDO4";
					};

					s2mpb03-ldo5 {
						linux,phandle = <0x66>;
						phandle = <0x66>;
						regulator-max-microvolt = <0x2ab980>;
						regulator-min-microvolt = <0x2ab980>;
						regulator-name = "CAM_VLDO5";
					};

					s2mpb03-ldo6 {
						linux,phandle = <0x67>;
						phandle = <0x67>;
						regulator-max-microvolt = <0x2ab980>;
						regulator-min-microvolt = <0x2ab980>;
						regulator-name = "CAM_VLDO6";
					};

					s2mpb03-ldo7 {
						linux,phandle = <0x68>;
						phandle = <0x68>;
						regulator-max-microvolt = <0x2ab980>;
						regulator-min-microvolt = <0x2ab980>;
						regulator-name = "CAM_VLDO7";
					};
				};
			};
		};
	};

	fragment@33 {
		target = <0xffffffff>;

		__overlay__ {

			camera_contig {
				compatible = "exynos9820-ion";
				ion,heapname = "camera_heap";
				ion,protection_id = <0xa>;
				ion,secure;
				reg = <0x0 0xdb900000 0x700000>;
			};

			secure_camera {
				compatible = "exynos9820-ion";
				ion,alignment = <0x10000>;
				ion,heapname = "secure_camera_heap";
				ion,protection_id = <0xb>;
				ion,secure;
				reg = <0x0 0xe1900000 0x2000000>;
			};
		};
	};

	fragment@34 {
		target = <0xffffffff>;

		__overlay__ {
			chub-irq-pin;
			chub-irq-pin-len = <0x0>;
			clock-names = "chub_bus", "cmgp_i2c";
			clocks = <0xffffffff 0x258 0xffffffff 0x7d>;
			os-type = "sensorhub/shub_ramen_m21.fw";
			sensor-ldo-en = <0xffffffff 0x0 0x1>;
			ssp-acc-position = <0x0>;
			ssp-light-cam-br = <0x3c 0x3c>;
			ssp-light-cam-lux = <0x64 0xc8>;
			ssp-light-position = <0x10 0x27 0x5 0x1f 0x2 0x6>;
			ssp-mag-array = [f1 51 a0 08 cf 45 00 2c d6 36 a6 c6 12 56 00 73 00 13 56 38 c4 fb 28 41 0c 68 6b];
			ssp-mag-position = <0x7>;
		};
	};

	fragment@35 {
		target = <0xffffffff>;

		__overlay__ {

			nfc_clk_req {
				linux,phandle = <0x1c>;
				phandle = <0x1c>;
				samsung,pin-pud = <0x1>;
				samsung,pins = "gpa2-6";
			};

			nfc_clk_req_nc {
				linux,phandle = <0x21>;
				phandle = <0x21>;
				samsung,pin-function = <0x0>;
				samsung,pin-pud = <0x1>;
				samsung,pins = "gpa2-6";
			};

			xclkout1_nc {
				linux,phandle = <0x22>;
				phandle = <0x22>;
				samsung,pin-function = <0x0>;
				samsung,pin-pud = <0x1>;
				samsung,pins = "gpq0-0";
			};
		};
	};

	fragment@36 {
		target = <0xffffffff>;

		__overlay__ {

			nfc-check {
				linux,phandle = <0x1d>;
				phandle = <0x1d>;
				samsung,pin-function = <0x0>;
				samsung,pin-pud = <0x0>;
				samsung,pin-pud-pdn = <0x0>;
				samsung,pins = "gpg0-3";
			};

			nfc_en {
				linux,phandle = <0x19>;
				phandle = <0x19>;
				samsung,pin-con-pdn = <0x3>;
				samsung,pin-drv = <0x0>;
				samsung,pin-function = <0x0>;
				samsung,pin-pud = <0x0>;
				samsung,pin-pud-pdn = <0x0>;
				samsung,pins = "gpg0-0";
			};

			nfc_en_nc {
				linux,phandle = <0x1e>;
				phandle = <0x1e>;
				samsung,pin-con-pdn = <0x2>;
				samsung,pin-function = <0x0>;
				samsung,pin-pud = <0x1>;
				samsung,pin-pud-pdn = <0x1>;
				samsung,pins = "gpg0-0";
			};

			nfc_firm {
				linux,phandle = <0x1a>;
				phandle = <0x1a>;
				samsung,pin-con-pdn = <0x3>;
				samsung,pin-function = <0x1>;
				samsung,pin-pud = <0x0>;
				samsung,pin-pud-pdn = <0x0>;
				samsung,pin-val = <0x0>;
				samsung,pins = "gpg1-0";
			};

			nfc_firm_nc {
				linux,phandle = <0x1f>;
				phandle = <0x1f>;
				samsung,pin-con-pdn = <0x2>;
				samsung,pin-function = <0x0>;
				samsung,pin-pud = <0x1>;
				samsung,pin-pud-pdn = <0x1>;
				samsung,pins = "gpg1-0";
			};

			nfc_pwr_en {
				linux,phandle = <0x1b>;
				phandle = <0x1b>;
				samsung,pin-con-pdn = <0x3>;
				samsung,pin-function = <0x1>;
				samsung,pin-pud = <0x0>;
				samsung,pin-pud-pdn = <0x0>;
				samsung,pin-val = <0x0>;
				samsung,pins = "gpg2-0";
			};

			nfc_pwr_en_nc {
				linux,phandle = <0x20>;
				phandle = <0x20>;
				samsung,pin-con-pdn = <0x2>;
				samsung,pin-function = <0x0>;
				samsung,pin-pud = <0x1>;
				samsung,pin-pud-pdn = <0x1>;
				samsung,pins = "gpg2-0";
			};
		};
	};

	fragment@37 {
		target = <0xffffffff>;

		__overlay__ {
			#address-cells = <0x1>;
			#size-cells = <0x0>;
			clock-frequency = <0x61a80>;
			samsung,reset-before-trans;
			status = "okay";

			sec-nfc@27 {
				clock-names = "oscclk_nfc";
				clocks = <0xffffffff 0x320>;
				compatible = "sec-nfc";
				interrupt-parent = <0xffffffff>;
				interrupts = <0x0 0x0 0x0>;
				pinctrl-0 = <0x19 0x1a 0x1b 0xffffffff 0x1c 0x1d>;
				pinctrl-1 = <0x1e 0x1f 0x20 0x21 0x22>;
				pinctrl-names = "default", "nfc_nc";
				reg = <0x27>;
				sec-nfc,check_nfc = <0xffffffff 0x3 0x0>;
				sec-nfc,clk_req-gpio = <0xffffffff 0x6 0x0>;
				sec-nfc,clk_use = <0x2>;
				sec-nfc,firm-gpio = <0xffffffff 0x0 0x1>;
				sec-nfc,irq-gpio = <0xffffffff 0x0 0x0>;
				sec-nfc,nfc_ap_clk;
				sec-nfc,pvdd_en = <0xffffffff 0x0 0x0>;
				sec-nfc,ven-gpio = <0xffffffff 0x0 0x0>;
			};
		};
	};

	fragment@38 {
		target = <0xffffffff>;

		__overlay__ {
			pinctrl-0 = <0x23>;
			pinctrl-names = "default";

			initial-state {
				linux,phandle = <0x23>;
				phandle = <0x23>;

				gpa0-6 {
					samsung,pin-function = <0x0>;
					samsung,pin-pud = <0x1>;
					samsung,pins = "gpa0-6";
				};

				gpa1-4 {
					samsung,pin-function = <0x0>;
					samsung,pin-pud = <0x1>;
					samsung,pins = "gpa1-4";
				};

				gpa2-5 {
					samsung,pin-function = <0x0>;
					samsung,pin-pud = <0x1>;
					samsung,pins = "gpa2-5";
				};
			};
		};
	};

	fragment@39 {
		target = <0xffffffff>;

		__overlay__ {
			pinctrl-0 = <0x24>;
			pinctrl-1 = <0x25>;
			pinctrl-names = "default", "sleep";

			initial-state {
				linux,phandle = <0x24>;
				phandle = <0x24>;

				gpm21-0 {
					samsung,pin-drv = <0x0>;
					samsung,pin-function = <0x1>;
					samsung,pin-pud = <0x0>;
					samsung,pins = "gpm21-0";
				};
			};

			sleep-state {
				linux,phandle = <0x25>;
				phandle = <0x25>;

				gpm12-0 {
					samsung,pin-con-pdn = <0x0>;
					samsung,pin-pud-pdn = <0x1>;
					samsung,pins = "gpm12-0";
				};

				gpm13-0 {
					samsung,pin-con-pdn = <0x0>;
					samsung,pin-pud-pdn = <0x1>;
					samsung,pins = "gpm13-0";
				};

				gpm14-0 {
					samsung,pin-con-pdn = <0x0>;
					samsung,pin-pud-pdn = <0x1>;
					samsung,pins = "gpm14-0";
				};

				gpm21-0 {
					samsung,pin-con-pdn = <0x3>;
					samsung,pin-pud-pdn = <0x0>;
					samsung,pins = "gpm21-0";
				};
			};
		};
	};

	fragment@4 {
		target = <0xffffffff>;

		__overlay__ {
			#address-cells = <0x1>;
			#size-cells = <0x0>;
			status = "okay";

			rt5665@1b {
				#sound-dai-cells = <0x1>;
				compatible = "realtek,rt5665";
				imp_table = <0x0 0xd 0x3 0x6 0xe 0x19 0x1 0x6 0x1a 0x35 0x0 0x6 0x36 0x67 0x0 0x6 0x68 0xffff 0x0 0x6>;
				interrupt-parent = <0xffffffff>;
				interrupts = <0x2 0x0 0x0>;
				linux,phandle = <0x4>;
				phandle = <0x4>;
				pinctrl-0 = <0x6>;
				pinctrl-names = "default";
				realtek,dmic2-data-pin = <0x2>;
				realtek,in1-differential;
				realtek,in3-differential;
				realtek,in4-differential;
				realtek,jd-src = <0x2>;
				realtek,mic-check-in-bg;
				realtek,offset-comp = <0x78 0x90 0xb0 0xc0 0xf0 0x110 0x130 0x180 0x1e0 0x200 0x2a0 0x300 0x3a0 0x400 0x500 0x600>;
				realtek,offset-comp-r = <0x1a 0x1f 0x20 0x2a 0x30 0x40 0x50 0x60 0x6f 0x7f 0xa0 0xb0 0xcf 0x100 0x120 0x160>;
				realtek,regulator_1v8 = <0x7>;
				realtek,regulator_3v3 = <0x8>;
				realtek,sar-hs-type = <0x2bc>;
				realtek,sar-pb-vth0 = <0x64>;
				realtek,sar-pb-vth1 = <0x91>;
				realtek,sar-pb-vth2 = <0xfa>;
				realtek,sar-pb-vth3 = <0x244>;
				reg = <0x1b>;
			};
		};
	};

	fragment@40 {
		target = <0xffffffff>;

		__overlay__ {
			pinctrl-0 = <0x26>;
			pinctrl-names = "sleep";

			sleep-state {
				linux,phandle = <0x26>;
				phandle = <0x26>;

				gpb2-0 {
					samsung,pin-con-pdn = <0x2>;
					samsung,pin-pud-pdn = <0x1>;
					samsung,pins = "gpb2-0";
				};

				gpb2-1 {
					samsung,pin-con-pdn = <0x2>;
					samsung,pin-pud-pdn = <0x1>;
					samsung,pins = "gpb2-1";
				};

				gpb2-2 {
					samsung,pin-con-pdn = <0x2>;
					samsung,pin-pud-pdn = <0x1>;
					samsung,pins = "gpb2-2";
				};

				gpb2-3 {
					samsung,pin-con-pdn = <0x2>;
					samsung,pin-pud-pdn = <0x1>;
					samsung,pins = "gpb2-3";
				};

				gpb2-4 {
					samsung,pin-con-pdn = <0x2>;
					samsung,pin-pud-pdn = <0x1>;
					samsung,pins = "gpb2-4";
				};
			};
		};
	};

	fragment@41 {
		target = <0xffffffff>;

		__overlay__ {
			pinctrl-0 = <0x27>;
			pinctrl-1 = <0x28>;
			pinctrl-names = "default", "sleep";

			initial-state {
				linux,phandle = <0x27>;
				phandle = <0x27>;

				gpc2-4 {
					samsung,pin-function = <0x0>;
					samsung,pin-pud = <0x1>;
					samsung,pins = "gpc2-4";
				};

				gpg0-1 {
					samsung,pin-function = <0x0>;
					samsung,pin-pud = <0x1>;
					samsung,pins = "gpg0-1";
				};

				gpg0-7 {
					samsung,pin-function = <0x0>;
					samsung,pin-pud = <0x1>;
					samsung,pins = "gpg0-7";
				};

				gpg1-4 {
					samsung,pin-function = <0x0>;
					samsung,pin-pud = <0x1>;
					samsung,pins = "gpg1-4";
				};

				gpg1-5 {
					samsung,pin-drv = <0x0>;
					samsung,pin-function = <0x1>;
					samsung,pin-pud = <0x0>;
					samsung,pin-val = <0x1>;
					samsung,pins = "gpg1-5";
				};

				gpg2-2 {
					samsung,pin-function = <0x0>;
					samsung,pin-pud = <0x1>;
					samsung,pins = "gpg2-2";
				};

				gpg2-5 {
					samsung,pin-function = <0x0>;
					samsung,pin-pud = <0x1>;
					samsung,pins = "gpg2-5";
				};

				gpg2-6 {
					samsung,pin-function = <0x0>;
					samsung,pin-pud = <0x1>;
					samsung,pins = "gpg2-6";
				};

				gpg3-1 {
					samsung,pin-drv = <0x0>;
					samsung,pin-function = <0x1>;
					samsung,pin-pud = <0x0>;
					samsung,pin-val = <0x1>;
					samsung,pins = "gpg3-1";
				};

				gpg3-2 {
					samsung,pin-function = <0x0>;
					samsung,pin-pud = <0x0>;
					samsung,pins = "gpg3-2";
				};

				gpg3-3 {
					samsung,pin-function = <0x0>;
					samsung,pin-pud = <0x0>;
					samsung,pins = "gpg3-3";
				};

				gpg3-4 {
					samsung,pin-function = <0x0>;
					samsung,pin-pud = <0x1>;
					samsung,pins = "gpg3-4";
				};

				gpg3-5 {
					samsung,pin-function = <0x0>;
					samsung,pin-pud = <0x1>;
					samsung,pins = "gpg3-5";
				};

				gpp0-4 {
					samsung,pin-function = <0x0>;
					samsung,pin-pud = <0x0>;
					samsung,pins = "gpp0-4";
				};

				gpp0-5 {
					samsung,pin-function = <0x0>;
					samsung,pin-pud = <0x0>;
					samsung,pins = "gpp0-5";
				};
			};

			sleep-state {
				linux,phandle = <0x28>;
				phandle = <0x28>;

				gpc1-2 {
					samsung,pin-con-pdn = <0x2>;
					samsung,pin-pud-pdn = <0x1>;
					samsung,pins = "gpc1-2";
				};

				gpc1-3 {
					samsung,pin-con-pdn = <0x2>;
					samsung,pin-pud-pdn = <0x1>;
					samsung,pins = "gpc1-3";
				};

				gpc2-2 {
					samsung,pin-con-pdn = <0x2>;
					samsung,pin-pud-pdn = <0x1>;
					samsung,pins = "gpc2-2";
				};

				gpc2-4 {
					samsung,pin-con-pdn = <0x2>;
					samsung,pin-pud-pdn = <0x1>;
					samsung,pins = "gpc2-4";
				};

				gpg0-1 {
					samsung,pin-con-pdn = <0x2>;
					samsung,pin-pud-pdn = <0x1>;
					samsung,pins = "gpg0-1";
				};

				gpg0-5 {
					samsung,pin-con-pdn = <0x3>;
					samsung,pin-pud-pdn = <0x0>;
					samsung,pins = "gpg0-5";
				};

				gpg0-6 {
					samsung,pin-con-pdn = <0x0>;
					samsung,pin-pud-pdn = <0x1>;
					samsung,pins = "gpg0-6";
				};

				gpg0-7 {
					samsung,pin-con-pdn = <0x2>;
					samsung,pin-pud-pdn = <0x1>;
					samsung,pins = "gpg0-7";
				};

				gpg1-2 {
					samsung,pin-con-pdn = <0x3>;
					samsung,pin-pud-pdn = <0x0>;
					samsung,pins = "gpg1-2";
				};

				gpg1-3 {
					samsung,pin-con-pdn = <0x3>;
					samsung,pin-pud-pdn = <0x0>;
					samsung,pins = "gpg1-3";
				};

				gpg1-4 {
					samsung,pin-con-pdn = <0x2>;
					samsung,pin-pud-pdn = <0x1>;
					samsung,pins = "gpg1-4";
				};

				gpg1-5 {
					samsung,pin-con-pdn = <0x1>;
					samsung,pin-pud-pdn = <0x0>;
					samsung,pins = "gpg1-5";
				};

				gpg2-1 {
					samsung,pin-con-pdn = <0x3>;
					samsung,pin-pud-pdn = <0x0>;
					samsung,pins = "gpg2-1";
				};

				gpg2-2 {
					samsung,pin-con-pdn = <0x2>;
					samsung,pin-pud-pdn = <0x1>;
					samsung,pins = "gpg2-2";
				};

				gpg2-3 {
					samsung,pin-con-pdn = <0x3>;
					samsung,pin-pud-pdn = <0x1>;
					samsung,pins = "gpg2-3";
				};

				gpg2-4 {
					samsung,pin-con-pdn = <0x3>;
					samsung,pin-pud-pdn = <0x0>;
					samsung,pins = "gpg2-4";
				};

				gpg2-5 {
					samsung,pin-con-pdn = <0x2>;
					samsung,pin-pud-pdn = <0x1>;
					samsung,pins = "gpg2-5";
				};

				gpg2-6 {
					samsung,pin-con-pdn = <0x2>;
					samsung,pin-pud-pdn = <0x1>;
					samsung,pins = "gpg2-6";
				};

				gpg2-7 {
					samsung,pin-con-pdn = <0x3>;
					samsung,pin-pud-pdn = <0x0>;
					samsung,pins = "gpg2-7";
				};

				gpg3-0 {
					samsung,pin-con-pdn = <0x3>;
					samsung,pin-pud-pdn = <0x0>;
					samsung,pins = "gpg3-0";
				};

				gpg3-1 {
					samsung,pin-con-pdn = <0x3>;
					samsung,pin-pud-pdn = <0x0>;
					samsung,pins = "gpg3-1";
				};

				gpg3-2 {
					samsung,pin-con-pdn = <0x2>;
					samsung,pin-pud-pdn = <0x0>;
					samsung,pins = "gpg3-2";
				};

				gpg3-3 {
					samsung,pin-con-pdn = <0x2>;
					samsung,pin-pud-pdn = <0x0>;
					samsung,pins = "gpg3-3";
				};

				gpg3-4 {
					samsung,pin-con-pdn = <0x2>;
					samsung,pin-pud-pdn = <0x1>;
					samsung,pins = "gpg3-4";
				};

				gpg3-5 {
					samsung,pin-con-pdn = <0x2>;
					samsung,pin-pud-pdn = <0x1>;
					samsung,pins = "gpg3-5";
				};

				gpg4-0 {
					samsung,pin-con-pdn = <0x3>;
					samsung,pin-pud-pdn = <0x0>;
					samsung,pins = "gpg4-0";
				};

				gpg4-2 {
					samsung,pin-con-pdn = <0x3>;
					samsung,pin-pud-pdn = <0x0>;
					samsung,pins = "gpg4-2";
				};

				gpp0-0 {
					samsung,pin-con-pdn = <0x2>;
					samsung,pin-pud-pdn = <0x0>;
					samsung,pins = "gpp0-0";
				};

				gpp0-1 {
					samsung,pin-con-pdn = <0x2>;
					samsung,pin-pud-pdn = <0x0>;
					samsung,pins = "gpp0-1";
				};

				gpp0-2 {
					samsung,pin-con-pdn = <0x2>;
					samsung,pin-pud-pdn = <0x0>;
					samsung,pins = "gpp0-2";
				};

				gpp0-3 {
					samsung,pin-con-pdn = <0x2>;
					samsung,pin-pud-pdn = <0x0>;
					samsung,pins = "gpp0-3";
				};

				gpp0-4 {
					samsung,pin-con-pdn = <0x2>;
					samsung,pin-pud-pdn = <0x0>;
					samsung,pins = "gpp0-4";
				};

				gpp0-5 {
					samsung,pin-con-pdn = <0x2>;
					samsung,pin-pud-pdn = <0x0>;
					samsung,pins = "gpp0-5";
				};

				gpp0-6 {
					samsung,pin-con-pdn = <0x2>;
					samsung,pin-pud-pdn = <0x0>;
					samsung,pins = "gpp0-6";
				};

				gpp0-7 {
					samsung,pin-con-pdn = <0x2>;
					samsung,pin-pud-pdn = <0x0>;
					samsung,pins = "gpp0-7";
				};

				gpp1-0 {
					samsung,pin-con-pdn = <0x2>;
					samsung,pin-pud-pdn = <0x0>;
					samsung,pins = "gpp1-0";
				};

				gpp1-1 {
					samsung,pin-con-pdn = <0x2>;
					samsung,pin-pud-pdn = <0x0>;
					samsung,pins = "gpp1-1";
				};

				gpp1-2 {
					samsung,pin-con-pdn = <0x2>;
					samsung,pin-pud-pdn = <0x0>;
					samsung,pins = "gpp1-2";
				};

				gpp1-3 {
					samsung,pin-con-pdn = <0x2>;
					samsung,pin-pud-pdn = <0x0>;
					samsung,pins = "gpp1-3";
				};

				gpp1-4 {
					samsung,pin-con-pdn = <0x2>;
					samsung,pin-pud-pdn = <0x0>;
					samsung,pins = "gpp1-4";
				};

				gpp1-5 {
					samsung,pin-con-pdn = <0x2>;
					samsung,pin-pud-pdn = <0x0>;
					samsung,pins = "gpp1-5";
				};
			};
		};
	};

	fragment@42 {
		target = <0xffffffff>;

		__overlay__ {

			btp-irq {
				linux,phandle = <0x2c>;
				phandle = <0x2c>;
				samsung,pin-drv = <0x3>;
				samsung,pin-function = <0xf>;
				samsung,pin-pud = <0x0>;
				samsung,pins = "gpa0-5";
			};

			btp-irq-sleep {
				linux,phandle = <0x29>;
				phandle = <0x29>;
				samsung,pin-drv = <0x3>;
				samsung,pin-function = <0x0>;
				samsung,pin-pud = <0x1>;
				samsung,pins = "gpa0-5";
			};
		};
	};

	fragment@43 {
		target = <0xffffffff>;

		__overlay__ {

			btp-ldo {
				linux,phandle = <0x2a>;
				phandle = <0x2a>;
				samsung,pin-drv = <0x0>;
				samsung,pin-function = <0x1>;
				samsung,pin-pud = <0x1>;
				samsung,pins = "gpg2-7";
			};

			btp-rst {
				linux,phandle = <0x2b>;
				phandle = <0x2b>;
				samsung,pin-drv = <0x0>;
				samsung,pin-function = <0x1>;
				samsung,pin-pud = <0x1>;
				samsung,pins = "gpg3-0";
			};

			spi17-miso-inactive {
				linux,phandle = <0x32>;
				phandle = <0x32>;
				samsung,pin-drv = <0x2>;
				samsung,pin-function = <0x0>;
				samsung,pin-pud = <0x1>;
				samsung,pins = "gpp2-6";
			};

			spi7-bus-inactive {
				linux,phandle = <0x31>;
				phandle = <0x31>;
				samsung,pin-drv = <0x2>;
				samsung,pin-function = <0x1>;
				samsung,pin-pud = <0x0>;
				samsung,pin-val = <0x0>;
				samsung,pins = "gpp2-4", "gpp2-5", "gpp2-7";
			};

			spi7-clk {
				linux,phandle = <0x2d>;
				phandle = <0x2d>;
				samsung,pin-drv = <0x2>;
				samsung,pin-function = <0x2>;
				samsung,pin-pud = <0x1>;
				samsung,pins = "gpp2-4";
			};

			spi7-cs {
				linux,phandle = <0x2e>;
				phandle = <0x2e>;
				samsung,pin-drv = <0x2>;
				samsung,pin-function = <0x2>;
				samsung,pin-pud = <0x3>;
				samsung,pins = "gpp2-7";
			};

			spi7-miso {
				linux,phandle = <0x2f>;
				phandle = <0x2f>;
				samsung,pin-drv = <0x2>;
				samsung,pin-function = <0x2>;
				samsung,pin-pud = <0x1>;
				samsung,pins = "gpp2-6";
			};

			spi7-mosi {
				linux,phandle = <0x30>;
				phandle = <0x30>;
				samsung,pin-drv = <0x2>;
				samsung,pin-function = <0x2>;
				samsung,pin-pud = <0x1>;
				samsung,pins = "gpp2-5";
			};
		};
	};

	fragment@44 {
		target = <0xffffffff>;

		__overlay__ {
			#address-cells = <0x1>;
			#size-cells = <0x0>;
			dma-mode;
			dmas = <0xffffffff 0x15 0xffffffff 0x14>;
			status = "okay";

			etspi-spi@0 {
				#gpio-cells = <0x2>;
				compatible = "etspi,et5xx";
				etspi-chipid = "ET520";
				etspi-drdyPin = <0xffffffff 0x5 0x0>;
				etspi-ldoPin = <0xffffffff 0x7 0x0>;
				etspi-orient = <0x1>;
				etspi-sleepPin = <0xffffffff 0x0 0x0>;
				gpio-controller;
				pinctrl-0 = <0x29 0x2a 0x2b>;
				pinctrl-1 = <0x2c 0x2d 0x2e 0x2f 0x30>;
				pinctrl-2 = <0x29 0x31 0x32>;
				pinctrl-3 = <0x2c>;
				pinctrl-4 = <0x29>;
				pinctrl-names = "default", "pins_poweron", "pins_poweroff", "pins_poweron_tz", "pins_poweroff_tz";
				reg = <0x0>;
				spi-max-frequency = <0xc65d40>;

				controller-data {
					cs-gpio = <0xffffffff 0x7 0x0>;
					samsung,spi-chip-select-mode = <0x0>;
					samsung,spi-feedback-delay = <0x0>;
				};
			};
		};
	};

	fragment@45 {
		target = <0xffffffff>;

		__overlay__ {

			if-pmic-irq {
				linux,phandle = <0x35>;
				phandle = <0x35>;
				samsung,pin-drv = <0x0>;
				samsung,pin-function = <0x0>;
				samsung,pin-pud = <0x0>;
				samsung,pins = "gpa2-2";
			};

			usbpd-irq {
				linux,phandle = <0x33>;
				phandle = <0x33>;
				samsung,pin-drv = <0x0>;
				samsung,pin-function = <0xf>;
				samsung,pin-pud = <0x0>;
				samsung,pins = "gpa2-3";
			};
		};
	};

	fragment@46 {
		target = <0xffffffff>;

		__overlay__ {
			#address-cells = <0x1>;
			#size-cells = <0x0>;
			i2c-gpio,delay-us = <0x5>;
			samsung,fix-doxfer-return;
			samsung,glitch-filter;
			samsung,i2c-max-bus-freq = <0x61a80>;
			status = "okay";

			usbpd-5713@33 {
				compatible = "sm5713-usbpd,i2c";
				pinctrl-0 = <0x33>;
				pinctrl-names = "default";
				reg = <0x33>;
				support_pd_role_swap;
				usbpd,usbpd_int = <0xffffffff 0x3 0x0>;
			};
		};
	};

	fragment@47 {
		target = <0xffffffff>;

		__overlay__ {
			#address-cells = <0x1>;
			#size-cells = <0x0>;
			samsung,fix-doxfer-return;
			samsung,glitch-filter;
			samsung,i2c-max-bus-freq = <0x61a80>;
			status = "okay";

			sm5713@49 {
				compatible = "siliconmitus,sm5713mfd";
				pinctrl-0 = <0x34 0x35>;
				pinctrl-names = "default";
				reg = <0x49>;
				sm5713,irq-gpio = <0xffffffff 0x2 0x0>;
				sm5713,wakeup;
			};
		};
	};

	fragment@48 {
		target = <0xffffffff>;

		__overlay__ {
			non_secure_mem_info = <0xdb900000 0x700000>;
			secure_mem_info = <0xe1900000 0x2000000>;

			fimc_is_dvfs {

				table0 {
					default_cam = <0xa8750>;
					default_hpg = <0x1>;
					default_int = <0x186a0>;
					default_int_cam = <0xa8750>;
					default_mif = <0x1fefc8>;
					desc = "dvfs table v0.0 for 48M/16M";
					dual_capture_cam = <0xa6040>;
					dual_capture_hpg = <0x1>;
					dual_capture_int = <0x186a0>;
					dual_capture_int_cam = <0xa6040>;
					dual_capture_mif = <0x1b5fd0>;
					dual_preview_cam = <0xa6040>;
					dual_preview_hpg = <0x1>;
					dual_preview_int = <0x186a0>;
					dual_preview_int_cam = <0xa1220>;
					dual_preview_mif = <0x14a140>;
					dual_sync_capture_cam = <0xa6040>;
					dual_sync_capture_hpg = <0x1>;
					dual_sync_capture_int = <0x186a0>;
					dual_sync_capture_int_cam = <0xa6040>;
					dual_sync_capture_mif = <0x1e8c50>;
					dual_sync_preview_cam = <0xa6040>;
					dual_sync_preview_hpg = <0x1>;
					dual_sync_preview_int = <0x186a0>;
					dual_sync_preview_int_cam = <0xa3930>;
					dual_sync_preview_mif = <0x177bb8>;
					dual_sync_preview_whd_cam = <0xa6040>;
					dual_sync_preview_whd_hpg = <0x1>;
					dual_sync_preview_whd_int = <0x186a0>;
					dual_sync_preview_whd_int_cam = <0xa6040>;
					dual_sync_preview_whd_mif = <0x177bb8>;
					dual_sync_video_fhd_cam = <0xa6040>;
					dual_sync_video_fhd_capture_cam = <0xa6040>;
					dual_sync_video_fhd_capture_hpg = <0x1>;
					dual_sync_video_fhd_capture_int = <0x186a0>;
					dual_sync_video_fhd_capture_int_cam = <0xa3930>;
					dual_sync_video_fhd_capture_mif = <0x1e8c50>;
					dual_sync_video_fhd_hpg = <0x1>;
					dual_sync_video_fhd_int = <0x186a0>;
					dual_sync_video_fhd_int_cam = <0xa3930>;
					dual_sync_video_fhd_mif = <0x177bb8>;
					dual_sync_video_uhd_cam = <0xa6040>;
					dual_sync_video_uhd_capture_cam = <0xa6040>;
					dual_sync_video_uhd_capture_hpg = <0x1>;
					dual_sync_video_uhd_capture_int = <0x186a0>;
					dual_sync_video_uhd_capture_int_cam = <0xa6040>;
					dual_sync_video_uhd_capture_mif = <0x1e8c50>;
					dual_sync_video_uhd_hpg = <0x1>;
					dual_sync_video_uhd_int = <0x186a0>;
					dual_sync_video_uhd_int_cam = <0xa6040>;
					dual_sync_video_uhd_mif = <0x1e8c50>;
					dual_sync_whd_capture_cam = <0xa6040>;
					dual_sync_whd_capture_hpg = <0x1>;
					dual_sync_whd_capture_int = <0x186a0>;
					dual_sync_whd_capture_int_cam = <0xa6040>;
					dual_sync_whd_capture_mif = <0x1e8c50>;
					dual_video_fhd_cam = <0xa6040>;
					dual_video_fhd_capture_cam = <0xa6040>;
					dual_video_fhd_capture_hpg = <0x1>;
					dual_video_fhd_capture_int = <0x186a0>;
					dual_video_fhd_capture_int_cam = <0xa3930>;
					dual_video_fhd_capture_mif = <0x177bb8>;
					dual_video_fhd_hpg = <0x1>;
					dual_video_fhd_int = <0x186a0>;
					dual_video_fhd_int_cam = <0xa1220>;
					dual_video_fhd_mif = <0x14a140>;
					dual_video_uhd_cam = <0xa6040>;
					dual_video_uhd_capture_cam = <0xa6040>;
					dual_video_uhd_capture_hpg = <0x1>;
					dual_video_uhd_capture_int = <0x186a0>;
					dual_video_uhd_capture_int_cam = <0xa6040>;
					dual_video_uhd_capture_mif = <0x1b5fd0>;
					dual_video_uhd_hpg = <0x1>;
					dual_video_uhd_int = <0x186a0>;
					dual_video_uhd_int_cam = <0xa3930>;
					dual_video_uhd_mif = <0x177bb8>;
					ext_front_cam = <0xa8750>;
					ext_front_hpg = <0x1>;
					ext_front_int = <0x186a0>;
					ext_front_int_cam = <0xa8750>;
					ext_front_mif = <0x1fefc8>;
					ext_secure_cam = <0xa8750>;
					ext_secure_hpg = <0x1>;
					ext_secure_int = <0x186a0>;
					ext_secure_int_cam = <0xa8750>;
					ext_secure_mif = <0x1fefc8>;
					front_capture_cam = <0xa3930>;
					front_capture_hpg = <0x1>;
					front_capture_int = <0x186a0>;
					front_capture_int_cam = <0xa6040>;
					front_capture_mif = <0x1b5fd0>;
					front_capture_remosaic_cam = <0xa8750>;
					front_capture_remosaic_hpg = <0x1>;
					front_capture_remosaic_int = <0xa2d78>;
					front_capture_remosaic_int_cam = <0xa8750>;
					front_capture_remosaic_mif = <0x1fefc8>;
					front_preview_cam = <0xa3930>;
					front_preview_full_cam = <0xa3930>;
					front_preview_full_hpg = <0x1>;
					front_preview_full_int = <0x186a0>;
					front_preview_full_int_cam = <0xa3930>;
					front_preview_full_mif = <0x1b5fd0>;
					front_preview_hpg = <0x1>;
					front_preview_int = <0x186a0>;
					front_preview_int_cam = <0xa1220>;
					front_preview_mif = <0x14a140>;
					front_preview_remosaic_cam = <0xa8750>;
					front_preview_remosaic_hpg = <0x1>;
					front_preview_remosaic_int = <0xa2d78>;
					front_preview_remosaic_int_cam = <0xa8750>;
					front_preview_remosaic_mif = <0x1fefc8>;
					front_video_cam = <0xa3930>;
					front_video_capture_cam = <0xa3930>;
					front_video_capture_hpg = <0x1>;
					front_video_capture_int = <0x186a0>;
					front_video_capture_int_cam = <0xa3930>;
					front_video_capture_mif = <0x1b5fd0>;
					front_video_hpg = <0x1>;
					front_video_int = <0x186a0>;
					front_video_int_cam = <0xa1220>;
					front_video_mif = <0x14a140>;
					front_vt1_cam = <0xa3930>;
					front_vt1_hpg = <0x1>;
					front_vt1_int = <0x186a0>;
					front_vt1_int_cam = <0xa1220>;
					front_vt1_mif = <0xf78f0>;
					front_vt2_cam = <0xa3930>;
					front_vt2_hpg = <0x1>;
					front_vt2_int = <0x186a0>;
					front_vt2_int_cam = <0xa1220>;
					front_vt2_mif = <0xf78f0>;
					front_vt4_cam = <0xa3930>;
					front_vt4_hpg = <0x1>;
					front_vt4_int = <0x186a0>;
					front_vt4_int_cam = <0xa1220>;
					front_vt4_mif = <0xf78f0>;
					max_cam = <0xa8750>;
					max_hpg = <0x1>;
					max_int = <0xa2d78>;
					max_int_cam = <0xa8750>;
					max_mif = <0x1fefc8>;
					preview_high_speed_fps_cam = <0xa3930>;
					preview_high_speed_fps_hpg = <0x1>;
					preview_high_speed_fps_int = <0x186a0>;
					preview_high_speed_fps_int_cam = <0xa3930>;
					preview_high_speed_fps_mif = <0x1b5fd0>;
					rear2_capture_cam = <0xa1220>;
					rear2_capture_hpg = <0x1>;
					rear2_capture_int = <0x186a0>;
					rear2_capture_int_cam = <0xa1220>;
					rear2_capture_mif = <0x177bb8>;
					rear2_preview_fhd_cam = <0x9eb10>;
					rear2_preview_fhd_hpg = <0x1>;
					rear2_preview_fhd_int = <0x186a0>;
					rear2_preview_fhd_int_cam = <0xa1220>;
					rear2_preview_fhd_mif = <0x14a140>;
					rear3_capture_cam = <0xa1220>;
					rear3_capture_hpg = <0x1>;
					rear3_capture_int = <0x186a0>;
					rear3_capture_int_cam = <0xa1220>;
					rear3_capture_mif = <0x177bb8>;
					rear3_preview_cam = <0xa1220>;
					rear3_preview_hpg = <0x1>;
					rear3_preview_int = <0x186a0>;
					rear3_preview_int_cam = <0xa1220>;
					rear3_preview_mif = <0x14a140>;
					rear3_video_cam = <0xa1220>;
					rear3_video_capture_cam = <0xa1220>;
					rear3_video_capture_hpg = <0x1>;
					rear3_video_capture_int = <0x186a0>;
					rear3_video_capture_int_cam = <0xa1220>;
					rear3_video_capture_mif = <0x177bb8>;
					rear3_video_hpg = <0x1>;
					rear3_video_int = <0x186a0>;
					rear3_video_int_cam = <0xa1220>;
					rear3_video_mif = <0x14a140>;
					rear_capture_cam = <0xa6040>;
					rear_capture_hpg = <0x1>;
					rear_capture_int = <0x186a0>;
					rear_capture_int_cam = <0xa6040>;
					rear_capture_mif = <0x1b5fd0>;
					rear_capture_remosaic_cam = <0xa8750>;
					rear_capture_remosaic_hpg = <0x1>;
					rear_capture_remosaic_int = <0x186a0>;
					rear_capture_remosaic_int_cam = <0xa6040>;
					rear_capture_remosaic_mif = <0x1fefc8>;
					rear_preview_fhd_cam = <0xa3930>;
					rear_preview_fhd_hpg = <0x1>;
					rear_preview_fhd_int = <0x186a0>;
					rear_preview_fhd_int_cam = <0xa3930>;
					rear_preview_fhd_mif = <0x14a140>;
					rear_preview_full_cam = <0xa3930>;
					rear_preview_full_hpg = <0x1>;
					rear_preview_full_int = <0x186a0>;
					rear_preview_full_int_cam = <0xa6040>;
					rear_preview_full_mif = <0x1b5fd0>;
					rear_preview_hd_cam = <0xa3930>;
					rear_preview_hd_hpg = <0x1>;
					rear_preview_hd_int = <0x186a0>;
					rear_preview_hd_int_cam = <0xa3930>;
					rear_preview_hd_mif = <0x14a140>;
					rear_preview_remosaic_cam = <0xa8750>;
					rear_preview_remosaic_hpg = <0x1>;
					rear_preview_remosaic_int = <0x186a0>;
					rear_preview_remosaic_int_cam = <0xa6040>;
					rear_preview_remosaic_mif = <0x1fefc8>;
					rear_preview_uhd_cam = <0xa3930>;
					rear_preview_uhd_hpg = <0x1>;
					rear_preview_uhd_int = <0x186a0>;
					rear_preview_uhd_int_cam = <0xa6040>;
					rear_preview_uhd_mif = <0x177bb8>;
					rear_video_fhd_cam = <0xa3930>;
					rear_video_fhd_capture_cam = <0xa6040>;
					rear_video_fhd_capture_hpg = <0x1>;
					rear_video_fhd_capture_int = <0x186a0>;
					rear_video_fhd_capture_int_cam = <0xa3930>;
					rear_video_fhd_capture_mif = <0x177bb8>;
					rear_video_fhd_hpg = <0x1>;
					rear_video_fhd_int = <0x186a0>;
					rear_video_fhd_int_cam = <0xa3930>;
					rear_video_fhd_mif = <0x177bb8>;
					rear_video_hd_cam = <0xa3930>;
					rear_video_hd_capture_cam = <0xa6040>;
					rear_video_hd_capture_hpg = <0x1>;
					rear_video_hd_capture_int = <0x186a0>;
					rear_video_hd_capture_int_cam = <0xa3930>;
					rear_video_hd_capture_mif = <0x177bb8>;
					rear_video_hd_hpg = <0x1>;
					rear_video_hd_int = <0x186a0>;
					rear_video_hd_int_cam = <0xa1220>;
					rear_video_hd_mif = <0x14a140>;
					rear_video_uhd_cam = <0xa3930>;
					rear_video_uhd_capture_cam = <0xa6040>;
					rear_video_uhd_capture_hpg = <0x1>;
					rear_video_uhd_capture_int = <0x186a0>;
					rear_video_uhd_capture_int_cam = <0xa6040>;
					rear_video_uhd_capture_mif = <0x1b5fd0>;
					rear_video_uhd_hpg = <0x1>;
					rear_video_uhd_int = <0x186a0>;
					rear_video_uhd_int_cam = <0xa3930>;
					rear_video_uhd_mif = <0x177bb8>;
					video_high_speed_120fps_cam = <0xa3930>;
					video_high_speed_120fps_hpg = <0x1>;
					video_high_speed_120fps_int = <0x186a0>;
					video_high_speed_120fps_int_cam = <0xa6040>;
					video_high_speed_120fps_mif = <0x1fefc8>;
					video_high_speed_240fps_cam = <0xa6040>;
					video_high_speed_240fps_hpg = <0x8>;
					video_high_speed_240fps_int = <0x186a0>;
					video_high_speed_240fps_int_cam = <0xa6040>;
					video_high_speed_240fps_mif = <0x1fefc8>;
					video_high_speed_480fps_cam = <0xa8750>;
					video_high_speed_480fps_hpg = <0x1>;
					video_high_speed_480fps_int = <0xa2d78>;
					video_high_speed_480fps_int_cam = <0xa8750>;
					video_high_speed_480fps_mif = <0x1fefc8>;
					video_high_speed_60fps_cam = <0xa3930>;
					video_high_speed_60fps_capture_cam = <0xa8750>;
					video_high_speed_60fps_capture_hpg = <0x1>;
					video_high_speed_60fps_capture_int = <0x186a0>;
					video_high_speed_60fps_capture_int_cam = <0xa8750>;
					video_high_speed_60fps_capture_mif = <0x1fefc8>;
					video_high_speed_60fps_hpg = <0x1>;
					video_high_speed_60fps_int = <0x186a0>;
					video_high_speed_60fps_int_cam = <0xa6040>;
					video_high_speed_60fps_mif = <0x1fefc8>;
				};
			};

			vender {
				check_sensor_vendor;
				front_sensor_id = <0xd6>;
				max_camera_num = <0x4>;
				max_supported_camera = <0x5>;
				need_i2c_config;
				rear2_sensor_id = <0xd2>;
				rear3_sensor_id = <0x27>;
				rear_sensor_id = <0x3d>;
				supported_cameraId = <0x0 0x1 0x17 0x32 0x34>;
				use_module_check;

				camera_info0 {
					cal_memory = <0x2>;
					companion = <0x0>;
					core_voltage = <0x0>;
					dual_open = <0x0>;
					isp = <0x0>;
					ois = <0x0>;
					position = <0x0>;
					read_version = <0x0>;
					upgrade = <0x0>;
					valid = <0x1>;
				};

				camera_info1 {
					cal_memory = <0x2>;
					companion = <0x0>;
					core_voltage = <0x0>;
					dual_open = <0x0>;
					isp = <0x0>;
					ois = <0x0>;
					position = <0x1>;
					read_version = <0x0>;
					upgrade = <0x0>;
					valid = <0x1>;
				};

				camera_info2 {
					cal_memory = <0x2>;
					companion = <0x0>;
					core_voltage = <0x0>;
					dual_open = <0x1>;
					isp = <0x0>;
					ois = <0x0>;
					position = <0x2>;
					read_version = <0x0>;
					upgrade = <0x0>;
					valid = <0x1>;
				};

				camera_info3 {
					cal_memory = <0x2>;
					companion = <0x0>;
					core_voltage = <0x0>;
					dual_open = <0x0>;
					isp = <0x0>;
					ois = <0x0>;
					position = <0x4>;
					read_version = <0x0>;
					upgrade = <0x0>;
					valid = <0x1>;
				};
			};
		};
	};

	fragment@49 {
		target = <0xffffffff>;

		__overlay__ {
			#address-cells = <0x1>;
			#size-cells = <0x0>;
			clock-frequency = <0x61a80>;
			gpios = <0xffffffff 0x0 0x0 0xffffffff 0x1 0x0>;
			pinctrl-0 = <0xffffffff>;
			pinctrl-1 = <0xffffffff>;
			pinctrl-2 = <0xffffffff>;
			pinctrl-names = "default", "on_i2c", "off_i2c";
			samsung,reset-before-trans;
			status = "okay";

			fimc-is-hi2021q@20 {
				compatible = "samsung,exynos5-fimc-is-cis-hi2021q";
				id = <0x1>;
				reg = <0x20>;
				sensor_f_number = <0xdc>;
				setfile = "setB";
				use_initial_ae;
			};
		};
	};

	fragment@5 {
		target = <0xffffffff>;

		__overlay__ {

			chg-en {
				linux,phandle = <0x34>;
				phandle = <0x34>;
				samsung,pin-drv = <0x0>;
				samsung,pin-function = <0x1>;
				samsung,pin-pud = <0x1>;
				samsung,pins = "gpg2-3";
			};
		};
	};

	fragment@50 {
		target = <0xffffffff>;

		__overlay__ {
			#address-cells = <0x1>;
			#size-cells = <0x0>;
			clock-frequency = <0xf4240>;
			gpios = <0xffffffff 0x2 0x0 0xffffffff 0x3 0x0>;
			pinctrl-0 = <0xffffffff>;
			pinctrl-1 = <0xffffffff>;
			pinctrl-2 = <0xffffffff>;
			pinctrl-names = "default", "on_i2c", "off_i2c";
			samsung,fast-plus-mode;
			samsung,reset-before-trans;
			status = "okay";

			fimc-is-gm2@5A {
				compatible = "samsung,exynos5-fimc-is-cis-gm2";
				id = <0x0>;
				reg = <0x2d>;
				sensor_f_number = <0xc8>;
				setfile = "setB";
			};
		};
	};

	fragment@51 {
		target = <0xffffffff>;

		__overlay__ {
			#address-cells = <0x1>;
			#size-cells = <0x0>;
			clock-frequency = <0x61a80>;
			gpios = <0xffffffff 0x4 0x0 0xffffffff 0x5 0x0>;
			pinctrl-0 = <0xffffffff>;
			pinctrl-1 = <0xffffffff>;
			pinctrl-2 = <0xffffffff>;
			pinctrl-names = "default", "on_i2c", "off_i2c";
			samsung,reset-before-trans;
			status = "okay";

			fimc-is-gc5035@6E {
				compatible = "samsung,exynos5-fimc-is-cis-gc5035";
				id = <0x2>;
				reg = <0x37>;
				sensor_f_number = <0xdc>;
				setfile = "setB";
				use_initial_ae;
			};
		};
	};

	fragment@52 {
		target = <0xffffffff>;

		__overlay__ {
			#address-cells = <0x1>;
			#size-cells = <0x0>;
			clock-frequency = <0x61a80>;
			gpios = <0xffffffff 0x6 0x0 0xffffffff 0x7 0x0>;
			pinctrl-0 = <0xffffffff>;
			pinctrl-1 = <0xffffffff>;
			pinctrl-2 = <0xffffffff>;
			pinctrl-names = "default", "on_i2c", "off_i2c";
			samsung,reset-before-trans;
			status = "okay";

			fimc-is-4ha@5A {
				compatible = "samsung,exynos5-fimc-is-cis-4ha";
				id = <0x3>;
				reg = <0x2d>;
				sensor_f_number = <0xdc>;
				setfile = "setB";
			};
		};
	};

	fragment@53 {
		target = <0xffffffff>;

		__overlay__ {
			#address-cells = <0x1>;
			#size-cells = <0x0>;
			clock-frequency = <0x61a80>;
			gpios = <0xffffffff 0x1 0x0 0xffffffff 0x0 0x0>;
			pinctrl-0 = <0xffffffff>;
			pinctrl-1 = <0xffffffff>;
			pinctrl-2 = <0xffffffff>;
			pinctrl-names = "default", "on_i2c", "off_i2c";
			samsung,reset-before-trans;
			status = "okay";

			rear3_eeprom@A0 {
				compatible = "samsung,rear3-eeprom-i2c";
				reg = <0x50>;
			};
		};
	};

	fragment@54 {
		target = <0xffffffff>;

		__overlay__ {
			#address-cells = <0x1>;
			#size-cells = <0x0>;
			clock-frequency = <0x61a80>;
			gpios = <0xffffffff 0x3 0x0 0xffffffff 0x2 0x0>;
			pinctrl-0 = <0xffffffff>;
			pinctrl-1 = <0xffffffff>;
			pinctrl-2 = <0xffffffff>;
			pinctrl-names = "default", "on_i2c", "off_i2c";
			samsung,reset-before-trans;
			status = "okay";

			fimc-is-actuator@18 {
				compatible = "samsung,exynos5-fimc-is-actuator-dw9808";
				id = <0x0>;
				place = <0x0>;
				reg = <0xc>;
			};

			front_eeprom@51 {
				compatible = "samsung,front-eeprom-i2c";
				reg = <0x51>;
			};

			rear_eeprom@58 {
				compatible = "samsung,rear-eeprom-i2c";
				reg = <0x58>;
				use_common_rom_position = <0x2>;
			};
		};
	};

	fragment@55 {
		target = <0xffffffff>;

		__overlay__ {

			sm5713-fled@49 {
				compatible = "siliconmitus,sm5713-fled";

				sm5713-fled@0 {
					flash-brightness = <0xf>;
					flash-en-gpio = <0xffffffff 0x6 0x0>;
					id = <0x0>;
					preflash-brightness = <0x4>;
					status = "okay";
					timeout = <0xff>;
					torch-brightness = <0x4>;
					torch-en-gpio = <0xffffffff 0x3 0x0>;
				};
			};
		};
	};

	fragment@56 {
		target = <0xffffffff>;

		__overlay__ {
			camif_mux_val = <0x182077>;
			csi_ch = <0x0>;
			csi_mux = <0x2>;
			dma_ch = <0x0 0x0 0x0 0x0 0x0 0x0 0x2 0x0>;
			flite_ch = <0x64>;
			id = <0x0>;
			is_bns = <0x0>;
			multi_ch = <0x2>;
			scenario = <0x0>;
			status = "okay";
			use_ssvc2_internal;
			use_ssvc3_internal;
			vc_ch = <0x0 0x1 0x2 0x3 0x0 0x1 0x0 0x3>;
		};
	};

	fragment@57 {
		target = <0xffffffff>;

		__overlay__ {
			camif_mux_val = <0x182077>;
			csi_ch = <0x1>;
			csi_mux = <0x2>;
			dma_ch = <0x1 0x1 0x1 0x1 0x2 0x2 0x2 0x2>;
			flite_ch = <0x64>;
			id = <0x2>;
			is_bns = <0x0>;
			multi_ch = <0x2>;
			phys = <0xffffffff 0x1>;
			scenario = <0x0>;
			status = "okay";
			vc_ch = <0x0 0x1 0x2 0x3 0x1 0x2 0x1 0x3>;
		};
	};

	fragment@58 {
		target = <0xffffffff>;

		__overlay__ {
			camif_mux_val = <0x2077>;
			camif_mux_val_s = <0x184240>;
			csi_ch = <0x2>;
			csi_mux = <0x2>;
			dma_ch = <0x2 0x2 0x2 0x2>;
			flite_ch = <0x64>;
			id = <0x1>;
			is_bns = <0x0>;
			multi_ch = <0x0>;
			scenario = <0x0>;
			status = "okay";
			vc_ch = <0x0 0x1 0x2 0x3>;
		};
	};

	fragment@59 {
		target = <0xffffffff>;

		__overlay__ {
			camif_mux_val = <0x182077>;
			csi_ch = <0x1>;
			csi_mux = <0x0>;
			dma_ch = <0x1 0x1 0x1 0x1>;
			flite_ch = <0x64>;
			id = <0x3>;
			interrupt-names = "csi", "mode0_VC0", "mode0_VC1", "mode0_VC2", "mode0_VC3";
			interrupts = <0x0 0x146 0x0 0x0 0x14c 0x0 0x0 0x14c 0x0 0x0 0x14c 0x0 0x0 0x14c 0x0>;
			is_bns = <0x0>;
			multi_ch = <0x2>;
			phys = <0xffffffff 0x0>;
			reg = <0x0 0x14410700 0x100 0x0 0x14410000 0x700>;
			reg-names = "phy", "csi";
			scenario = <0x0>;
			status = "okay";
			vc_ch = <0x0 0x1 0x2 0x3>;

			sensor3-ch-mode0 {
				linux,phandle = <0x6e>;
				phandle = <0x6e>;
				reg = <0x14460000 0x100 0x14460400 0x100 0x14460100 0x100 0x14460400 0x100 0x14460200 0x100 0x14460400 0x100 0x14460300 0x100 0x14460400 0x100>;
			};
		};
	};

	fragment@6 {
		target = <0xffffffff>;

		__overlay__ {
			parts = "vbmeta,boot,system,vendor,product,odm,prism,optics,vbmeta_samsung,recovery,dtbo,keystorage";
			status = "okay";
		};
	};

	fragment@60 {
		target = <0xffffffff>;

		__overlay__ {

			grip-int {
				linux,phandle = <0x14>;
				phandle = <0x14>;
				samsung,pin-function = <0xf>;
				samsung,pin-pud = <0x0>;
				samsung,pins = "gpa2-7";
			};
		};
	};

	fragment@61 {
		target = <0xffffffff>;

		__overlay__ {

			grip-gpio {
				linux,phandle = <0x13>;
				phandle = <0x13>;
				samsung,pin-function = <0x0>;
				samsung,pin-pud = <0x0>;
				samsung,pins = "gpp1-2", "gpp1-3";
			};

			grip-i2c {
				linux,phandle = <0x12>;
				phandle = <0x12>;
				samsung,pin-function = <0x2>;
				samsung,pin-pud = <0x0>;
				samsung,pins = "gpp1-2", "gpp1-3";
			};
		};
	};

	fragment@7 {
		target = <0xffffffff>;

		__overlay__ {
			status = "disabled";
		};
	};

	fragment@8 {
		target = <0xffffffff>;

		__overlay__ {
			status = "okay";

			dwc3 {
				dr_mode = "otg";
				maximum-speed = "high-speed";
			};
		};
	};

	fragment@9 {
		target = <0xffffffff>;

		__overlay__ {
			dr_mode = "otg";
			ldo-names = "vdd_ldo12", "vdd_ldo13", "vdd_ldo14";
			maximum-speed = "high-speed";
		};
	};

	fragment@battery {
		target-path = [2f 00];

		__overlay__ {

			battery {
				#io-channel-cells = <0x5>;
				battery,adc_check_count = <0x5>;
				battery,age_data = <0x0 0x10fe 0x10b8 0x109a 0x5d 0x12c 0x10ea 0x10a4 0x1086 0x5c 0x190 0x10d6 0x1090 0x1072 0x5b 0x2bc 0x10c2 0x107c 0x105e 0x5a 0x3e8 0x1090 0x104a 0x102c 0x59>;
				battery,battery_check_type = <0x0>;
				battery,battery_full_capacity = <0x1770>;
				battery,cable_check_type = <0x4>;
				battery,cable_source_type = <0x1>;
				battery,charger_name = "sm5713-charger";
				battery,charging_reset_time = <0x0>;
				battery,charging_total_time = <0x3840>;
				battery,check_adc_max = <0x5a0>;
				battery,check_adc_min = <0x0>;
				battery,check_count = <0x0>;
				battery,chg_charging_limit_current = <0x708>;
				battery,chg_float_voltage = <0x10fe>;
				battery,chg_gpio_full_check = <0x0>;
				battery,chg_heating_prevention_method = <0x0>;
				battery,chg_high_temp = <0x1ea>;
				battery,chg_high_temp_recovery = <0x1c2>;
				battery,chg_input_limit_current = <0x3e8>;
				battery,chg_ocp_current = <0x1194>;
				battery,chg_polarity_full_check = <0x1>;
				battery,chg_temp_check_type = <0x2>;
				battery,chg_temp_table_adc = <0x125 0x190 0x22e 0x284 0x2fb 0x377 0x405 0x4a8 0x564 0x61c 0x707 0x7e0 0x8da 0x9c6 0xaa0 0xb74 0xc37 0xcde 0xd5f 0xddd 0xe35>;
				battery,chg_temp_table_data = <0x384 0x320 0x2bc 0x28a 0x258 0x226 0x1f4 0x1c2 0x190 0x15e 0x12c 0xfa 0xc8 0x96 0x64 0x32 0x0 0xffffffce 0xffffff9c 0xffffff6a 0xffffff38>;
				battery,chg_thermal_source = <0x3>;
				battery,chip_vendor = "LSI";
				battery,cisd_alg_index = <0x7>;
				battery,cisd_max_voltage_thr = <0x1130>;
				battery,enable_water_resistance;
				battery,expired_time = <0x3ed0>;
				battery,fgsrc_switch_name = "sm5713-fuelgauge";
				battery,fuelgauge_name = "sm5713-fuelgauge";
				battery,full_check_count = <0x1>;
				battery,full_check_type = <0x2>;
				battery,full_check_type_2nd = <0x2>;
				battery,full_condition_soc = <0x5d>;
				battery,full_condition_type = <0xd>;
				battery,full_condition_vcell = <0x109a>;
				battery,health_condition = <0x384 0x0 0x4b0 0x0 0x5dc 0x0>;
				battery,hv_charging_total_time = <0x2a30>;
				battery,ignore_cisd_index = <0x0 0x3c0>;
				battery,ignore_cisd_index_d = <0x0 0x78>;
				battery,inbat_voltage = <0x1>;
				battery,inbat_voltage_table_adc = <0xb01 0xaf3 0xadf 0xac1 0xaa8 0xa8d 0xa78 0xa5e 0xa44 0xa25 0xa05 0x9e8 0x9cd 0x9ae 0x992 0x97a 0x961 0x944 0x927 0x911 0x8f2>;
				battery,inbat_voltage_table_data = <0x111f 0x1100 0x10d2 0x109d 0x106c 0x1038 0x1005 0xfd5 0xfa2 0xf72 0xf3f 0xf0c 0xed9 0xea6 0xe76 0xe46 0xe11 0xde0 0xdaf 0xd80 0xd4a>;
				battery,input_current_by_siop_20 = <0x3e8>;
				battery,max_charging_current = <0x92e>;
				battery,max_input_current = <0xbb8>;
				battery,max_input_voltage = <0x2328>;
				battery,mix_high_chg_temp = <0x1e0>;
				battery,mix_high_temp = <0x190>;
				battery,mix_high_temp_recovery = <0x172>;
				battery,monitor_initial_count = <0x0>;
				battery,normal_charging_total_time = <0x4650>;
				battery,ovp_uvlo_check_type = <0x3>;
				battery,pd_charging_charge_power = <0x3a98>;
				battery,polling_time = <0xa 0x1e 0x1e 0x1e 0xe10>;
				battery,polling_type = <0x1>;
				battery,pre_afc_input_current = <0x1f4>;
				battery,prepare_ta_delay = <0x0>;
				battery,recharge_check_count = <0x1>;
				battery,recharge_condition_soc = <0x62>;
				battery,recharge_condition_type = <0x4>;
				battery,recharge_condition_vcell = <0x10b8>;
				battery,recharging_expired_time = <0x1518>;
				battery,recharging_total_time = <0x1518>;
				battery,rp_current_abnormal_rp3 = <0x708>;
				battery,rp_current_rdu_rp3 = <0x834>;
				battery,rp_current_rp1 = <0x1f4>;
				battery,rp_current_rp2 = <0x5dc>;
				battery,rp_current_rp3 = <0xbb8>;
				battery,siop_call_cc_current = <0x14a>;
				battery,siop_call_cv_current = <0x14a>;
				battery,siop_charging_limit_current = <0x3e8>;
				battery,siop_event_check_type = <0x1>;
				battery,siop_hv_charging_limit_current = <0x3e8>;
				battery,siop_hv_input_limit_current = <0x2bc>;
				battery,siop_hv_wireless_charging_limit_current = <0x2bc>;
				battery,siop_hv_wireless_input_limit_current = <0x258>;
				battery,siop_input_limit_current = <0x4b0>;
				battery,siop_store_hv_wireless_input_limit_current = <0x1c2>;
				battery,siop_wireless_charging_limit_current = <0x2bc>;
				battery,siop_wireless_input_limit_current = <0x258>;
				battery,sleep_mode_limit_current = <0x1f4>;
				battery,standard_curr = <0x92e>;
				battery,swelling_drop_float_voltage = <0x1036>;
				battery,swelling_high_rechg_voltage = <0xfa0>;
				battery,swelling_high_temp_block = <0x19a>;
				battery,swelling_high_temp_current = <0x6d6>;
				battery,swelling_high_temp_recov = <0x186>;
				battery,swelling_high_temp_topoff = <0x12c>;
				battery,swelling_low_rechg_voltage = <0xfa0>;
				battery,swelling_low_temp_block_1st = <0x96>;
				battery,swelling_low_temp_block_2nd = <0x32>;
				battery,swelling_low_temp_current = <0x47e>;
				battery,swelling_low_temp_current_2nd = <0x226>;
				battery,swelling_low_temp_recov_1st = <0xaa>;
				battery,swelling_low_temp_recov_2nd = <0x46>;
				battery,swelling_low_temp_topoff = <0x12c>;
				battery,swelling_wc_high_temp_current = <0x384>;
				battery,swelling_wc_low_temp_current = <0x384>;
				battery,swelling_wc_low_temp_current_2nd = <0x15e>;
				battery,technology = <0x2>;
				battery,temp_adc_type = <0x1>;
				battery,temp_check_count = <0x1>;
				battery,temp_check_type = <0x2>;
				battery,temp_high_recovery_lpm = <0x1e0>;
				battery,temp_high_recovery_normal = <0x1e0>;
				battery,temp_high_threshold_lpm = <0x1f4>;
				battery,temp_high_threshold_normal = <0x1f4>;
				battery,temp_highlimit_recovery_lpm = <0x2a8>;
				battery,temp_highlimit_recovery_normal = <0x2a8>;
				battery,temp_highlimit_threshold_lpm = <0x2bc>;
				battery,temp_highlimit_threshold_normal = <0x2bc>;
				battery,temp_low_recovery_lpm = <0x14>;
				battery,temp_low_recovery_normal = <0x14>;
				battery,temp_low_threshold_lpm = <0x0>;
				battery,temp_low_threshold_normal = <0x0>;
				battery,temp_table_adc = <0x132 0x190 0x22b 0x287 0x2f3 0x370 0x3fe 0x49e 0x54e 0x60f 0x6ea 0x7d1 0x8bf 0x9af 0xa91 0xb5f 0xc27 0xccd 0xd55 0xdd8 0xe16>;
				battery,temp_table_data = <0x384 0x320 0x2bc 0x28a 0x258 0x226 0x1f4 0x1c2 0x190 0x15e 0x12c 0xfa 0xc8 0x96 0x64 0x32 0x0 0xffffffce 0xffffff9c 0xffffff6a 0xffffff38>;
				battery,thermal_source = <0x3>;
				battery,ttf_hv_charge_current = <0x820>;
				battery,ttf_hv_wireless_charge_current = <0x41a>;
				battery,ttf_wireless_charge_current = <0x384>;
				battery,usb_charging_total_time = <0x8ca0>;
				battery,usb_temp_check_type = <0x0>;
				battery,usb_thermal_source = <0x0>;
				battery,vendor = "Battery";
				battery,wc_full_input_limit_current = <0x64>;
				battery,wpc_charging_limit_current = <0x258>;
				battery,wpc_high_recovery_normal = <0x1ae>;
				battery,wpc_high_temp = <0x17c>;
				battery,wpc_high_temp_recovery = <0x168>;
				battery,wpc_high_threshold_normal = <0x1c2>;
				battery,wpc_lcd_on_charging_limit_current = <0x1c2>;
				battery,wpc_lcd_on_high_temp = <0x17c>;
				battery,wpc_lcd_on_high_temp_rec = <0x168>;
				battery,wpc_low_recovery_normal = <0x14>;
				battery,wpc_low_threshold_normal = <0x0>;
				battery,wpc_store_high_temp = <0x168>;
				battery,wpc_store_high_temp_recovery = <0x154>;
				battery,wpc_store_lcd_on_charging_limit_current = <0x190>;
				battery,wpc_store_lcd_on_high_temp = <0x168>;
				battery,wpc_store_lcd_on_high_temp_rec = <0x12c>;
				battery,wpc_temp_check_type = <0x0>;
				battery,wpc_temp_control_source = <0x0>;
				battery,wpc_temp_lcd_on_control_source = <0x0>;
				battery,wpc_thermal_source = <0x0>;
				compatible = "samsung,sec-battery";
				io-channel-names = "adc-temp", "adc-in-bat", "adc-chg-temp";
				io-channel-ranges;
				io-channels = <0xffffffff 0x1 0xffffffff 0x2 0xffffffff 0x3>;
				pinctrl-names = "default";
				status = "okay";
			};

			cable-info {
				default_charging_current = <0x834>;
				default_input_current = <0x708>;
				full_check_current_1st = <0x258>;
				full_check_current_2nd = <0x12c>;

				current_group_1 {
					cable_number = <0x2 0x13 0x15 0x16 0x17 0x1e>;
					charging_current = <0x1f4>;
					input_current = <0x1f4>;
				};

				current_group_10 {
					cable_number = <0xb 0xe 0x10 0x1c 0x23>;
					charging_current = <0x92e>;
					input_current = <0x2ee>;
				};

				current_group_11 {
					cable_number = <0x1d>;
					charging_current = <0x578>;
					input_current = <0x1f4>;
				};

				current_group_12 {
					cable_number = <0x1 0x4>;
					charging_current = <0x226>;
					input_current = <0x1db>;
				};

				current_group_13 {
					cable_number = <0x22>;
					charging_current = <0x92e>;
					input_current = <0x4b0>;
				};

				current_group_2 {
					cable_number = <0x19 0x1f>;
					charging_current = <0x3e8>;
					input_current = <0x3e8>;
				};

				current_group_3 {
					cable_number = <0x5 0x20>;
					charging_current = <0x5dc>;
					input_current = <0x5dc>;
				};

				current_group_4 {
					cable_number = <0x6 0x7 0x8>;
					charging_current = <0x92e>;
					input_current = <0x672>;
				};

				current_group_5 {
					cable_number = <0x9>;
					charging_current = <0x92e>;
					input_current = <0x672>;
				};

				current_group_6 {
					cable_number = <0xa 0xc 0xf 0x1b 0x21>;
					charging_current = <0x92e>;
					input_current = <0x334>;
				};

				current_group_7 {
					cable_number = <0xd>;
					charging_current = <0x92e>;
					input_current = <0x2ee>;
				};

				current_group_8 {
					cable_number = <0x18>;
					charging_current = <0x1c2>;
					input_current = <0x3e8>;
				};

				current_group_9 {
					cable_number = <0x1a>;
					charging_current = <0x708>;
					input_current = <0x7d0>;
				};
			};

			pdic-manager {
				pdic,giveback = <0x0>;
				pdic,max_current = <0x7d0>;
				pdic,max_power = <0x1388>;
				pdic,max_voltage = <0x1770>;
				pdic,min_current = <0x1f4>;
				pdic,no_usb_suspend = <0x1>;
				pdic,op_power = <0x9c4>;
				pdic,usb_com_capable = <0x1>;
				source,max_power = <0x9c4>;
				source,max_voltage = <0x1388>;
				source,min_voltage = <0xfa0>;
			};

			sm5713-fuelgauge {
				fuelgauge,capacity_calculation_type = <0x1f>;
				fuelgauge,capacity_max = <0x3e8>;
				fuelgauge,capacity_max_margin = <0x12c>;
				fuelgauge,capacity_min = <0x0>;
				fuelgauge,cv_data = <0x942 0x366 0x82b 0x85a 0x370 0x7c7 0x7b6 0x379 0x75e 0x75e 0x382 0x6f5 0x6d6 0x389 0x697 0x668 0x390 0x63a 0x5f0 0x398 0x5d0 0x598 0x39e 0x574 0x52a 0x3a4 0x50d 0x4de 0x3aa 0x4a5 0x46d 0x3af 0x43a 0x438 0x3b4 0x3d2 0x3e1 0x3b9 0x369 0x3af 0x3bc 0x31f 0x390 0x3c1 0x2b6 0x348 0x3c6 0x250 0x318 0x3cb 0x1ef 0x2ea 0x3d0 0x186 0x2b8 0x3d3 0x128 0x288 0x3d7 0xc0 0x25c 0x3db 0x62 0x223 0x3e3 0x0>;
				fuelgauge,fuel_alert_soc = <0x1>;
				fuelgauge,low_temp_limit = <0x64>;
				fuelgauge,sw_v_empty_recover_voltage = <0xd98>;
				fuelgauge,sw_v_empty_voltage = <0xc80>;
				fuelgauge,sw_v_empty_voltage_cisd = <0xc1c>;
				fuelgauge,ttf_capacity = <0x12a7>;
				fuelgauge,using_hw_vempty;
				fuelgauge,using_temp_compensation;
				status = "okay";

				battery_params {
					battery,id = <0x0>;
					battery0,age_cntl = <0x325>;
					battery0,arsm = <0x1 0x3 0x1 0x6>;
					battery0,battery_table0 = <0x1400 0x1b33 0x1c2a 0x1d6c 0x1d86 0x1da2 0x1dbb 0x1ddb 0x1df0 0x1e30 0x1e4f 0x1e5d 0x1e7e 0x1ea7 0x1edc 0x1f3d 0x1f6f 0x1fa0 0x1ff1 0x2050 0x2082 0x20ee 0x2239 0x2400>;
					battery0,battery_table1 = <0x0 0x4c 0x166 0x44c 0x733 0xa00 0xce6 0xfcc 0x1299 0x1b33 0x2100 0x23cc 0x2980 0x2f4c 0x3500 0x3ab3 0x3d99 0x4080 0x4633 0x4be6 0x4ecc 0x5480 0x6400 0x6419>;
					battery0,battery_table2 = <0x4b 0x44 0x40 0x3e 0x3c 0x3b 0x38 0x37 0x35 0x34 0x34 0x33 0x33 0x33 0x33 0x32>;
					battery0,battery_type = <0x1130 0x0 0x29e2>;
					battery0,curr_cal = <0x877d 0x877d 0x877d 0x8080 0x8080 0x8080>;
					battery0,curr_offset = <0x1 0x0 0x0 0x0 0x0 0x0 0x0>;
					battery0,cycle_cfg = <0x0 0x0 0x0>;
					battery0,data_ver = <0x4>;
					battery0,dtcd_value = <0x1>;
					battery0,ext_temp_cal = <0x0 0x2 0x1 0x2 0x1 0x1 0x2 0x3 0x2 0x3>;
					battery0,full_offset = <0x0 0x32 0x0 0xd1 0x90>;
					battery0,misc = <0x0>;
					battery0,mix_value = <0x103 0x4>;
					battery0,q_max_table = <0x29e2 0x2932 0x2882 0x27d2 0x261a>;
					battery0,rce_value = <0x4e1 0x3e6 0x1d7>;
					battery0,rs_value = <0xa4 0x147 0x146 0x3800 0x7a>;
					battery0,tcal_ioff = <0x2 0x30>;
					battery0,tem_poff = <0xd48 0x32 0xcb2 0x32>;
					battery0,temp_cal = <0x0 0x6 0x1 0xb 0xffffffff 0x1 0x6 0x1 0x9 0x1>;
					battery0,temp_offset = <0x1 0xb 0x1 0x1 0x8 0xffffffff>;
					battery0,temp_std = <0x19>;
					battery0,temp_volcal = <0x1 0xf 0x1>;
					battery0,topoff_soc = <0x0 0x3 0x258>;
					battery0,v_alarm = <0xc1c 0x0>;
					battery0,v_max_table = <0x2239 0x2213 0x21f3 0x21d2 0x217f>;
					battery0,v_offset_cancel = <0x0 0x0 0x64 0xa>;
					battery0,vit_period = <0xa0a>;
					battery0,volt_cal = <0x8012 0x8012>;
				};
			};
		};
	};

	fragment@camera {
		target-path = [2f 00];

		__overlay__ {

			fimc-fimc_is_module_gm2@5A {
				compatible = "samsung,sensor-module-gm2";
				gpio_mclk = <0xffffffff 0x0 0x1>;
				gpio_reset = <0xffffffff 0x1 0x1>;
				id = <0x0>;
				linux,phandle = <0x69>;
				mclk_ch = <0x0>;
				phandle = <0x69>;
				pinctrl-0 = <0xffffffff>;
				pinctrl-1 = <0xffffffff>;
				pinctrl-2;
				pinctrl-3;
				pinctrl-names = "pin0", "pin1", "pin2", "release";
				position = <0x0>;
				sensor_i2c_addr = <0x2d>;
				sensor_i2c_ch = <0x1>;
				shared_mclk;
				status = "okay";
				use_pdaf;

				af {
					i2c_addr = <0x18>;
					i2c_ch = <0x5>;
					product_name = <0x13>;
				};

				flash {
					product_name = <0xb>;
				};

				internal_vc {
					vc_list = <0x2 0x2 0x1 0x3 0x4 0x1>;
				};
			};

			fimc-is-flash-gpio@0 {
				compatible = "samsung,sensor-flash-sm5713";
				flash-gpio = <0xffffffff 0x6 0x1>;
				id = <0x0>;
				linux,phandle = <0x6a>;
				phandle = <0x6a>;
				status = "okay";
				torch-gpio = <0xffffffff 0x3 0x1>;
			};

			fimc-is_sensor_4ha@5A {
				compatible = "samsung,sensor-module-4ha";
				gpio_cam_a2p8_en = <0xffffffff 0x6 0x1>;
				gpio_mclk = <0xffffffff 0x2 0x1>;
				gpio_reset = <0xffffffff 0x4 0x1>;
				id = <0x3>;
				linux,phandle = <0x6c>;
				mclk_ch = <0x2>;
				phandle = <0x6c>;
				pinctrl-0;
				pinctrl-1 = <0xffffffff>;
				pinctrl-2 = <0xffffffff>;
				pinctrl-3;
				pinctrl-names = "pin0", "pin1", "pin2", "release";
				position = <0x4>;
				status = "okay";
			};

			fimc-is_sensor_gc5035@6E {
				compatible = "samsung,sensor-module-gc5035";
				gpio_mclk = <0xffffffff 0x0 0x1>;
				gpio_reset = <0xffffffff 0x7 0x1>;
				id = <0x2>;
				linux,phandle = <0x6b>;
				mclk_ch = <0x0>;
				phandle = <0x6b>;
				pinctrl-0;
				pinctrl-1 = <0xffffffff>;
				pinctrl-2 = <0xffffffff>;
				pinctrl-3;
				pinctrl-names = "pin0", "pin1", "pin2", "release";
				position = <0x2>;
				shared_mclk;
				status = "okay";
			};

			fimc-is_sensor_hi2021q@20 {
				compatible = "samsung,sensor-module-hi2021q";
				gpio_mclk = <0xffffffff 0x1 0x1>;
				gpio_reset = <0xffffffff 0x7 0x1>;
				id = <0x1>;
				linux,phandle = <0x6d>;
				mclk_ch = <0x1>;
				phandle = <0x6d>;
				pinctrl-0 = <0xffffffff>;
				pinctrl-1 = <0xffffffff>;
				pinctrl-2;
				pinctrl-3;
				pinctrl-names = "pin0", "pin1", "pin2", "release";
				position = <0x1>;
				sensor_i2c_ch = <0x0>;
				status = "okay";
			};
		};
	};

	fragment@inputbooster {
		target-path = [2f 00];

		__overlay__ {

			input_booster {
				#address-cells = <0x1>;
				#size-cells = <0x0>;
				compatible = "input_booster";
				status = "okay";

				booster_key@1 {
					input_booster,cpu_freqs = <0x1174c0>;
					input_booster,dma_latency = <0x0>;
					input_booster,head_times = <0x1f4>;
					input_booster,hmp_boost = <0x1>;
					input_booster,int_freqs = <0x0>;
					input_booster,kfc_freqs = <0x0>;
					input_booster,label = "KEY";
					input_booster,levels = <0x1>;
					input_booster,mif_freqs = <0x0>;
					input_booster,phase_times = <0x0>;
					input_booster,tail_times = <0x1f4>;
					input_booster,type = <0x0>;
				};

				booster_key@10 {
					input_booster,cpu_freqs = <0x1702a0>;
					input_booster,dma_latency = <0x0>;
					input_booster,head_times = <0x2bc>;
					input_booster,hmp_boost = <0x1>;
					input_booster,int_freqs = <0x0>;
					input_booster,kfc_freqs = <0x101148>;
					input_booster,label = "KEY_TWO";
					input_booster,levels = <0x1>;
					input_booster,mif_freqs = <0x0>;
					input_booster,phase_times = <0x0>;
					input_booster,tail_times = <0x2bc>;
					input_booster,type = <0x9>;
				};

				booster_key@2 {
					input_booster,cpu_freqs = <0x1174c0>;
					input_booster,dma_latency = <0x0>;
					input_booster,head_times = <0x0>;
					input_booster,hmp_boost = <0x1>;
					input_booster,int_freqs = <0x0>;
					input_booster,kfc_freqs = <0x0>;
					input_booster,label = "TOUCHKEY";
					input_booster,levels = <0x1>;
					input_booster,mif_freqs = <0x0>;
					input_booster,phase_times = <0x0>;
					input_booster,tail_times = <0xc8>;
					input_booster,type = <0x1>;
				};

				booster_key@3 {
					input_booster,cpu_freqs = <0x1174c0 0x1174c0 0xe4840>;
					input_booster,dma_latency = <0x0 0x0 0x0>;
					input_booster,head_times = <0x82 0x82 0x0>;
					input_booster,hmp_boost = <0x1 0x1 0x1>;
					input_booster,int_freqs = <0x0 0x0 0x0>;
					input_booster,kfc_freqs = <0xc4c70 0xc4c70 0xc4c70>;
					input_booster,label = "TOUCH";
					input_booster,levels = <0x1 0x2 0x3>;
					input_booster,mif_freqs = <0xf78f0 0xf78f0 0xf78f0>;
					input_booster,phase_times = <0x0 0x0 0x0>;
					input_booster,tail_times = <0x0 0x0 0x1f4>;
					input_booster,type = <0x2>;
				};

				booster_key@4 {
					input_booster,cpu_freqs = <0x1174c0 0xe4840>;
					input_booster,dma_latency = <0x0 0x0>;
					input_booster,head_times = <0x3e8 0x0>;
					input_booster,hmp_boost = <0x1 0x1>;
					input_booster,int_freqs = <0x0 0x0>;
					input_booster,kfc_freqs = <0xc4c70 0xc4c70>;
					input_booster,label = "MULTITOUCH";
					input_booster,levels = <0x1 0x2>;
					input_booster,mif_freqs = <0xf78f0 0xf78f0>;
					input_booster,phase_times = <0x0 0x0>;
					input_booster,tail_times = <0x0 0x1f4>;
					input_booster,type = <0x3>;
				};

				booster_key@5 {
					input_booster,cpu_freqs = <0x1174c0 0x1174c0>;
					input_booster,dma_latency = <0x0 0x0>;
					input_booster,head_times = <0x82 0x82>;
					input_booster,hmp_boost = <0x1 0x1>;
					input_booster,int_freqs = <0x0 0x0>;
					input_booster,kfc_freqs = <0xc4c70 0xc4c70>;
					input_booster,label = "KEYBOARD";
					input_booster,levels = <0x1 0x2>;
					input_booster,mif_freqs = <0x0 0x0>;
					input_booster,phase_times = <0x0 0x0>;
					input_booster,tail_times = <0x0 0x0>;
					input_booster,type = <0x4>;
				};

				booster_key@6 {
					input_booster,cpu_freqs = <0x1174c0 0xe4840>;
					input_booster,dma_latency = <0x0 0x0>;
					input_booster,head_times = <0x82 0x0>;
					input_booster,hmp_boost = <0x1 0x1>;
					input_booster,int_freqs = <0x0 0x0>;
					input_booster,kfc_freqs = <0xc4c70 0xc4c70>;
					input_booster,label = "MOUSE";
					input_booster,levels = <0x1 0x2>;
					input_booster,mif_freqs = <0x0 0x0>;
					input_booster,phase_times = <0x0 0x0>;
					input_booster,tail_times = <0x0 0x1f4>;
					input_booster,type = <0x5>;
				};

				booster_key@7 {
					input_booster,cpu_freqs = <0x1174c0 0x0>;
					input_booster,dma_latency = <0x0 0x0>;
					input_booster,head_times = <0x82 0x0>;
					input_booster,hmp_boost = <0x1 0x0>;
					input_booster,int_freqs = <0x0 0x0>;
					input_booster,kfc_freqs = <0xc4c70 0x0>;
					input_booster,label = "MOUSE WHEEL";
					input_booster,levels = <0x1 0x2>;
					input_booster,mif_freqs = <0x0 0x0>;
					input_booster,phase_times = <0x0 0x0>;
					input_booster,tail_times = <0x0 0x0>;
					input_booster,type = <0x6>;
				};

				booster_key@8 {
					input_booster,cpu_freqs = <0x1174c0 0xe4840>;
					input_booster,dma_latency = <0x0 0x0>;
					input_booster,head_times = <0x82 0x0>;
					input_booster,hmp_boost = <0x1 0x1>;
					input_booster,int_freqs = <0x0 0x0>;
					input_booster,kfc_freqs = <0xc4c70 0xc4c70>;
					input_booster,label = "PEN HOVER";
					input_booster,levels = <0x1 0x2>;
					input_booster,mif_freqs = <0x0 0x0>;
					input_booster,phase_times = <0x0 0x0>;
					input_booster,tail_times = <0x0 0x1f4>;
					input_booster,type = <0x7>;
				};

				booster_key@9 {
					input_booster,bimc_freqs = <0x0 0x0>;
					input_booster,cpu_freqs = <0x1fbd00 0xe4840>;
					input_booster,dma_latency = <0x0 0x0>;
					input_booster,head_times = <0x82 0x0>;
					input_booster,hmp_boost = <0x1 0x1>;
					input_booster,kfc_freqs = <0x1a94b0 0xc4c70>;
					input_booster,label = "PEN";
					input_booster,levels = <0x1 0x2>;
					input_booster,tail_times = <0x0 0x258>;
					input_booster,type = <0x8>;
				};
			};
		};
	};

	fragment@lcd {
		target-path = [2f 00];

		__overlay__ {

			decon_board_ea8076 {
				gpio_con = <0xffffffff 0x7 0x0>;
				gpio_err = <0xffffffff 0x1 0x1>;
				gpio_lcd_en_1p8 = <0xffffffff 0x2 0x0>;
				gpio_lcd_en_3p0 = <0xffffffff 0x4 0x0>;
				gpio_lcd_rst = <0xffffffff 0x3 0x0>;
				gpio_pcd = <0xffffffff 0x1 0x1>;
				linux,phandle = <0x1>;
				phandle = <0x1>;

				dsim_reset_panel {
					type = "gpio,high", "gpio_lcd_rst", "delay,usleep", "1000", "gpio,low", "gpio_lcd_rst", "delay,usleep", "1000", "gpio,high", "gpio_lcd_rst", "delay,usleep", "10000";
				};

				dsim_set_panel_power_disable {
					type = "gpio,low", "gpio_lcd_rst", "delay,usleep", "10000", "gpio,low", "gpio_lcd_en_1p8", "delay,usleep", "5000", "gpio,low", "gpio_lcd_en_3p0", "delay,usleep", "5000";
				};

				dsim_set_panel_power_enable {
					type = "gpio,high", "gpio_lcd_en_1p8", "delay,usleep", "1000", "gpio,high", "gpio_lcd_en_3p0", "delay,usleep", "10000";
				};
			};

			ea8076 {
				cmd_underrun_lp_ref = <0x81c>;
				data_lane = <0x4>;
				decon_board = <0x1>;
				dsc_cnt = <0x0>;
				dsc_en = <0x0>;
				dsc_slice_num = <0x0>;
				linux,phandle = <0x2>;
				mic_en = <0x0>;
				mic_ratio = <0x0>;
				mic_ver = <0x0>;
				mode = <0x2>;
				mres_en = <0x0>;
				noncontinuous_clklane = <0x0>;
				phandle = <0x2>;
				resolution = <0x438 0x924>;
				size = <0x44 0x93>;
				timing,dsi-escape-clk = <0x10>;
				timing,dsi-hs-clk = <0x4b0>;
				timing,h-porch = <0x2 0x2 0x2>;
				timing,pmsk = <0x3 0x115 0x1 0x0>;
				timing,refresh = <0x3c>;
				timing,v-porch = <0xf 0x3 0x1>;
				type_of_ddi = <0x1>;
				update_min = <0x438 0x2>;
			};
		};
	};

	fragment@model {
		target-path = [2f 00];

		__overlay__ {
			#address-cells = <0x2>;
			#size-cells = <0x1>;
			model = "Samsung M21 SWA OPEN REV00 board based on Exynos9611";

			abc_hub {
				compatible = "samsung,abc_hub";
				status = "okay";

				bootc {
					bootc,time_spec_eng = <0x15f90>;
					bootc,time_spec_fac = <0xea60>;
					bootc,time_spec_user = <0x11170>;
				};
			};

			argos {
				#address-cells = <0x1>;
				compatible = "samsung,argos";

				boot_device@1 {
					net_boost,label = "IPC";
					net_boost,node = "rmnet0 rmnet1 rmnet2 rmnet3 rmnet4 rmnet5 rmnet6 rmnet7 umts_dm0";
					net_boost,table = <0x32 0x0 0x0 0xde2b0 0x0 0xce4c8 0x0 0x0 0x0 0x0 0x64 0x0 0x0 0x143bb0 0x0 0xf78f0 0x0 0x0 0x0 0x0 0xc8 0x0 0x0 0x176830 0x0 0x14a140 0x0 0x0 0x0 0x0 0x12c 0xfde800 0x0 0x163780 0x0 0x177bb8 0x0 0x0 0x0 0x0>;
					net_boost,table_size = <0x4>;
				};

				boot_device@2 {
					net_boost,label = "CLAT";
					net_boost,node = "clat clat4 v4-rmnet0 v4-rmnet1 v4-rmnet2 v4-rmnet3 v4-rmnet4 v4-rmnet5 v4-rmnet6 v4-rmnet7";
					net_boost,table = <0x64 0xfde80 0x0 0x0 0x0 0x0 0x0 0xf78f0 0x0 0x0 0x0 0x0 0x96 0x130b00 0x0 0x0 0x0 0x0 0x0 0x14a140 0x0 0x0 0x0 0x0 0xc8 0x163780 0x0 0x0 0x0 0x0 0x0 0x1fefc8 0x0 0x0 0x0 0x0>;
					net_boost,table_size = <0x3>;
				};

				boot_device@3 {
					net_boost,label = "USB";
					net_boost,node = "rndis0";
					net_boost,table = <0x0 0x0 0x0 0x0 0x0 0x0 0x0 0x0 0x1 0x0>;
					net_boost,table_size = <0x1>;
				};
			};

			dwmmc2@13550000 {
				#address-cells = <0x1>;
				#size-cells = <0x0>;
				bypass-for-allpass;
				card-detect = <0xffffffff 0x4 0xf>;
				card-detect-delay = <0xc8>;
				card-detect-gpio;
				card-detect-invert;
				card-init-hwacg-ctrl;
				ciu_clkin = <0x19 0x32 0x32 0x19 0x32 0x64 0xc8 0x32 0x32>;
				clk-drive-number = <0x4>;
				clock-frequency = <0x2faf0800>;
				data-timeout = <0xc8>;
				desc-size = <0x4>;
				fifo-depth = <0x40>;
				hto-timeout = <0x50>;
				num-ref-clks = <0x9>;
				num-slots = <0x1>;
				pinctrl-0 = <0xffffffff 0xffffffff 0xffffffff 0xffffffff 0x11>;
				pinctrl-1 = <0xffffffff>;
				pinctrl-2 = <0xffffffff>;
				pinctrl-3 = <0xffffffff>;
				pinctrl-4 = <0xffffffff>;
				pinctrl-names = "default", "fast-slew-rate-1x", "fast-slew-rate-2x", "fast-slew-rate-3x", "fast-slew-rate-4x";
				qos-dvfs-int-level = <0x82208>;
				qos-dvfs-mif-level = <0xa50a0>;
				samsung,dw-mshc-ciu-div = <0x3>;
				samsung,dw-mshc-ddr-timing = <0x3 0x0 0x2 0x1>;
				samsung,dw-mshc-sdr-timing = <0x3 0x0 0x2 0x0>;
				samsung,dw-mshc-sdr104-timing = <0x3 0x0 0x3 0x0>;
				samsung,dw-mshc-sdr50-timing = <0x3 0x0 0x4 0x2>;
				sd-uhs-sdr104;
				sd-uhs-sdr50;
				sec-sd-slot-type = <0x2>;
				skip-init-mmc-scan;
				status = "okay";
				supports-4bit;
				supports-cmd23;
				supports-erase;
				supports-highspeed;

				slot@0 {
					bus-width = <0x4>;
					disable-wp;
					reg = <0x0>;
				};
			};

			exynos_rgt {
				compatible = "samsung,exynos-rgt";
			};

			fixed-rate-clocks {

				oscclk {
					clock-frequency = <0x18cba80>;
					compatible = "samsung,exynos9610-oscclk";
				};
			};

			fixedregulator@1 {
				compatible = "regulator-fixed";
				linux,phandle = <0x61>;
				phandle = <0x61>;
				regulator-always-on;
				regulator-boot-on;
				regulator-max-microvolt = <0x401640>;
				regulator-min-microvolt = <0x401640>;
				regulator-name = "V_SYS";
			};

			gnss_pdata {
				compatible = "samsung,gnss_shdmem_if";
				fault_info = <0x1 0x200000 0x180000>;
				interrupt-names = "ACTIVE", "WATCHDOG", "WAKEUP", "REQ_INIT";
				interrupts = <0x0 0x1b 0x0 0x0 0x51 0x0 0x0 0x50 0x0 0x0 0x4f 0x0>;
				mbox_info = <0xb>;
				mbx,int_ap2gnss_ack_wake_clr = <0x4>;
				mbx,int_ap2gnss_ack_wake_set = <0x3>;
				mbx,int_ap2gnss_bcmd = <0x0>;
				mbx,int_ap2gnss_ipc_msg = <0x2>;
				mbx,int_ap2gnss_req_fault_info = <0x1>;
				mbx,irq_gnss2ap_bcmd = <0x0>;
				mbx,irq_gnss2ap_ipc_msg = <0x2>;
				mbx,irq_gnss2ap_req_wake_clr = <0x4>;
				mbx,irq_gnss2ap_rsp_fault_info = <0x1>;
				mbx,reg_bcmd_ctrl = <0x0 0x1 0x2 0x3>;
				memory-region = <0xffffffff>;
				reg_rx_head = <0x1 0x3>;
				reg_rx_ipc_msg = <0x1 0x5>;
				reg_rx_tail = <0x1 0x2>;
				reg_tx_head = <0x1 0x1>;
				reg_tx_ipc_msg = <0x1 0x4>;
				reg_tx_tail = <0x1 0x0>;
				shmem,device_node_name = "gnss_ipc";
				shmem,ipc_offset = <0x380000>;
				shmem,ipc_reg_cnt = <0x20>;
				shmem,ipc_size = <0x80000>;
				shmem,name = "KEPLER";
				status = "okay";
			};

			gpio_keys {
				#address-cells = <0x1>;
				#size-cells = <0x0>;
				compatible = "gpio-keys";
				pinctrl-0 = <0xc 0xd 0xe>;
				pinctrl-names = "default";
				status = "okay";

				button@2 {
					gpios = <0xffffffff 0x6 0xf>;
					label = "gpio-keys: KEY_VOLUMEDOWN";
					linux,code = <0x72>;
				};

				button@3 {
					gpios = <0xffffffff 0x5 0xf>;
					label = "gpio-keys: KEY_VOLUMEUP";
					linux,code = <0x73>;
				};

				button@4 {
					gpio-key,wakeup = <0x1>;
					gpios = <0xffffffff 0x7 0xf>;
					label = "gpio-keys: KEY_POWER";
					linux,code = <0x74>;
				};
			};

			i2c@13870000 {
				#address-cells = <0x1>;
				#size-cells = <0x0>;
				linux,phandle = <0x60>;
				phandle = <0x60>;
				samsung,i2c-max-bus-freq = <0x61a80>;
				samsung,i2c-sda-delay = <0x64>;
				status = "okay";

				mms_ts@48 {
					compatible = "melfas,mms_ts";
					enable_settings_aot;
					melfas,area-size = <0x85 0x10a 0x155>;
					melfas,event_info = <0x8 0xc 0x0>;
					melfas,fw_name = "tsp_melfas/mss100_m21.fw";
					melfas,irq-gpio = <0xffffffff 0x0 0x0>;
					melfas,max_x_y = <0xfff 0xfff>;
					melfas,no_vsync;
					melfas,node_info = <0xf 0x20 0x0>;
					melfas,regulator_boot_on;
					melfas,scl-gpio = <0xffffffff 0x1 0x0>;
					melfas,sda-gpio = <0xffffffff 0x0 0x0>;
					melfas,support_lpm = "true";
					melfas,support_model_feature;
					melfas,vdd_en = "tsp_ldo_en";
					pinctrl-0 = <0xf>;
					pinctrl-1 = <0x10>;
					pinctrl-names = "on_state", "off_state";
					reg = <0x48>;
					support_ear_detect_mode;
					support_open_short_test;
				};
			};

			i2c@20 {
				compatible = "i2c-gpio";
				gpios = <0xffffffff 0x2 0x0 0xffffffff 0x3 0x0>;
				i2c-gpio,delay-us = <0x2>;
				pinctrl-0 = <0x12>;
				pinctrl-1 = <0x12>;
				pinctrl-2 = <0x13>;
				pinctrl-names = "default", "on_i2c", "off_i2c";

				a96t3x6@20 {
					a96t3x6,firmup_cmd = <0x3b>;
					a96t3x6,fw_path = "abov/a96t326_m31.fw";
					a96t3x6,irq_gpio = <0xffffffff 0x7 0x0>;
					a96t3x6,ldo_en = <0xffffffff 0x1 0x0>;
					compatible = "a96t3x6";
					interrupt-parent = <0xffffffff>;
					interrupts = <0x7 0x0 0x0>;
					pinctrl-0 = <0x14 0x15>;
					pinctrl-names = "default";
					reg = <0x20>;
				};
			};

			mcu_ipc@11920000 {
				compatible = "samsung,exynos-shd-ipc-mailbox";
				interrupts = <0x0 0x28 0x0>;
				linux,phandle = <0x5f>;
				mcu,id = <0x0>;
				mcu,irq_affinity_mask = <0x3>;
				mcu,name = "mcu_ipc_cp";
				phandle = <0x5f>;
				reg = <0x0 0x11920000 0x180>;
			};

			mcu_ipc@11A00000 {
				compatible = "samsung,exynos-shd-ipc-mailbox";
				interrupts = <0x0 0x2b 0x0>;
				linux,phandle = <0xb>;
				mcu,id = <0x1>;
				mcu,name = "mcu_ipc_gnss";
				phandle = <0xb>;
				reg = <0x0 0x11a00000 0x180>;
			};

			mif_pdata {
				gpios = <0xffffffff 0x2 0x0 0xffffffff 0x3 0x0 0xffffffff 0x4 0x0 0xffffffff 0x5 0x0>;
				pinctrl-names = "default";
			};

			nad_balancer {
				compatible = "samsung,sec_nad_balancer";
				nad_balancer,timeout = <0x190>;
				status = "okay";

				qos {

					cl0 {
						qos,delay_time = <0xa>;
						qos,label = "LIT";
						qos,table = <0x1a94b0 0x18fe70 0x176830 0x163780 0x143bb0 0x12a570 0x110f30 0x101148 0xde2b0 0xc4c70 0xab630 0x91ff0 0x62638>;
						qos,table_size = <0xd>;
					};

					cl1 {
						qos,delay_time = <0xa>;
						qos,label = "BIG";
						qos,table = <0x234f10 0x21b8d0 0x215340 0x1fbd00 0x1e26c0 0x1cf610 0x1afa40 0x196400 0x1702a0 0x163780 0x14a140 0x130b00 0x1174c0 0xfde80 0xe4840>;
						qos,table_size = <0xf>;
					};

					mif {
						qos,delay_time = <0xa>;
						qos,label = "MIF";
						qos,table = <0x1fefc8 0x1e8c50 0x1b5fd0 0x177bb8 0xcbbc40 0xf78f0 0xce4c8 0xa50a0 0x854d0 0x664b8>;
						qos,table_size = <0xa>;
					};
				};

				sleep {
					sleep,resume_threshold = <0x3e8>;
					sleep,suspend_threshold = <0x3e8>;
				};
			};

			sec_abc {
				compatible = "samsung,sec_abc";
				status = "okay";

				aicl {
					aicl,label = "battery aicl";
					aicl,threshold_count = <0x5>;
					aicl,threshold_time = <0x12c>;
				};

				gpu {
					gpu,label = "GPU fault";
					gpu,threshold_count = <0x14>;
					gpu,threshold_time = <0x4b0>;
				};
			};

			sec_thermistor@0 {
				adc_array = <0x116 0x182 0x225 0x27f 0x2f7 0x374 0x405 0x4a7 0x560 0x60f 0x6f3 0x7b8 0x8a9 0x987 0xa50 0xb11 0xbc4 0xc60 0xcdb 0xd45 0xd94>;
				compatible = "samsung,sec-thermistor";
				id = <0x0>;
				io-channel-names = "adc-ap-temp";
				io-channel-ranges;
				io-channels = <0xffffffff 0x0>;
				status = "okay";
				temp_array = <0x384 0x320 0x2bc 0x28a 0x258 0x226 0x1f4 0x1c2 0x190 0x15e 0x12c 0xfa 0xc8 0x96 0x64 0x32 0x0 0xffffffce 0xffffff9c 0xffffff6a 0xffffff38>;
				thermistor_name = "sec-ap-thermistor";
			};

			sec_thermistor@6 {
				adc_array = <0x11a 0x18c 0x22d 0x28d 0x306 0x382 0x416 0x4b6 0x56d 0x629 0x705 0x7d7 0x8c0 0x9a1 0xa6d 0xb30 0xbe1 0xc79 0xcf9 0xd62 0xdb5>;
				compatible = "samsung,sec-thermistor";
				id = <0x1>;
				io-channel-names = "adc-wf-temp";
				io-channel-ranges;
				io-channels = <0xffffffff 0x6>;
				status = "okay";
				temp_array = <0x384 0x320 0x2bc 0x28a 0x258 0x226 0x1f4 0x1c2 0x190 0x15e 0x12c 0xfa 0xc8 0x96 0x64 0x32 0x0 0xffffffce 0xffffff9c 0xffffff6a 0xffffff38>;
				thermistor_name = "sec-wf-thermistor";
			};

			secgpio_dvs {
				compatible = "samsung,exynos9610-secgpio-dvs";
				status = "okay";
			};

			speedy@11a10000 {
				#address-cells = <0x1>;
				#size-cells = <0x0>;
				status = "okay";

				s2mpu09mfd@00 {
					acpm-ipc-channel = <0x2>;
					check_jigon = <0x0>;
					compatible = "samsung,s2mpu09mfd";
					i2c-speedy-address;
					init_time,hour = <0xc>;
					init_time,mday = <0x1>;
					init_time,min = <0x0>;
					init_time,mon = <0x0>;
					init_time,sec = <0x0>;
					init_time,wday = <0x2>;
					init_time,year = <0x77>;
					interrupt-parent = <0xffffffff>;
					interrupts = <0x2 0x0 0x0>;
					pinctrl-0 = <0x9 0xa>;
					pinctrl-names = "default";
					reg = <0x0>;
					s2mpu09,irq-gpio = <0xffffffff 0x0 0x0>;
					s2mpu09,wakeup = "enabled";
					smpl_en = "enabled";
					smpl_timer_val = <0x0>;
					wtsr_en = "enabled";
					wtsr_timer_val = <0x3>;

					regulators {

						BUCK1 {
							linux,phandle = <0x3e>;
							phandle = <0x3e>;
							regulator-always-on;
							regulator-initial-mode = <0x2>;
							regulator-max-microvolt = <0x10c8e0>;
							regulator-min-microvolt = <0x7a120>;
							regulator-name = "vdd_mif";
							regulator-ramp-delay = <0x2ee0>;
						};

						BUCK2 {
							linux,phandle = <0x3f>;
							phandle = <0x3f>;
							regulator-always-on;
							regulator-initial-mode = <0x1>;
							regulator-max-microvolt = <0x13d620>;
							regulator-min-microvolt = <0x7a120>;
							regulator-name = "vdd_cpucl1";
							regulator-ramp-delay = <0x2ee0>;
						};

						BUCK3 {
							linux,phandle = <0x40>;
							phandle = <0x40>;
							regulator-always-on;
							regulator-initial-mode = <0x1>;
							regulator-max-microvolt = <0x13d620>;
							regulator-min-microvolt = <0x7a120>;
							regulator-name = "vdd_cpucl0";
							regulator-ramp-delay = <0x2ee0>;
						};

						BUCK4 {
							linux,phandle = <0x41>;
							phandle = <0x41>;
							regulator-always-on;
							regulator-initial-mode = <0x2>;
							regulator-max-microvolt = <0x10c8e0>;
							regulator-min-microvolt = <0x7a120>;
							regulator-name = "vdd_int";
							regulator-ramp-delay = <0x2ee0>;
						};

						BUCK5 {
							linux,phandle = <0x42>;
							phandle = <0x42>;
							regulator-always-on;
							regulator-initial-mode = <0x2>;
							regulator-max-microvolt = <0x124f80>;
							regulator-min-microvolt = <0x7a120>;
							regulator-name = "vdd_g3d";
							regulator-ramp-delay = <0x2ee0>;
						};

						BUCK6 {
							linux,phandle = <0x43>;
							phandle = <0x43>;
							regulator-always-on;
							regulator-initial-mode = <0x2>;
							regulator-max-microvolt = <0x13d620>;
							regulator-min-microvolt = <0x7a120>;
							regulator-name = "vdd_cam_vipx";
							regulator-ramp-delay = <0x2ee0>;
						};

						BUCK7 {
							linux,phandle = <0x44>;
							phandle = <0x44>;
							regulator-always-on;
							regulator-initial-mode = <0x3>;
							regulator-max-microvolt = <0x13d620>;
							regulator-min-microvolt = <0x7a120>;
							regulator-name = "vdd2_mem";
							regulator-ramp-delay = <0x2ee0>;
						};

						BUCK8 {
							linux,phandle = <0x45>;
							phandle = <0x45>;
							regulator-always-on;
							regulator-initial-mode = <0x3>;
							regulator-max-microvolt = <0x16e360>;
							regulator-min-microvolt = <0x124f80>;
							regulator-name = "vdd_lldo";
							regulator-ramp-delay = <0x2ee0>;
						};

						BUCK9 {
							linux,phandle = <0x46>;
							phandle = <0x46>;
							regulator-always-on;
							regulator-initial-mode = <0x3>;
							regulator-max-microvolt = <0x200b20>;
							regulator-min-microvolt = <0x1b7740>;
							regulator-name = "vdd_mldo";
							regulator-ramp-delay = <0x2ee0>;
						};

						LDO1 {
							linux,phandle = <0x47>;
							phandle = <0x47>;
							regulator-always-on;
							regulator-initial-mode = <0x3>;
							regulator-max-microvolt = <0x13d620>;
							regulator-min-microvolt = <0xaae60>;
							regulator-name = "vdd_ldo1";
							regulator-ramp-delay = <0x2ee0>;
						};

						LDO10 {
							linux,phandle = <0x50>;
							phandle = <0x50>;
							regulator-always-on;
							regulator-initial-mode = <0x1>;
							regulator-max-microvolt = <0x13d620>;
							regulator-min-microvolt = <0x7a120>;
							regulator-name = "vdd_ldo10";
							regulator-ramp-delay = <0x2ee0>;
						};

						LDO11 {
							linux,phandle = <0x51>;
							phandle = <0x51>;
							regulator-always-on;
							regulator-initial-mode = <0x3>;
							regulator-max-microvolt = <0x13d620>;
							regulator-min-microvolt = <0x7a120>;
							regulator-name = "vdd_ldo11";
							regulator-ramp-delay = <0x2ee0>;
						};

						LDO12 {
							linux,phandle = <0x52>;
							phandle = <0x52>;
							regulator-initial-mode = <0x3>;
							regulator-max-microvolt = <0x13d620>;
							regulator-min-microvolt = <0xc3500>;
							regulator-name = "vdd_ldo12";
							regulator-ramp-delay = <0x2ee0>;
						};

						LDO13 {
							linux,phandle = <0x53>;
							phandle = <0x53>;
							regulator-initial-mode = <0x3>;
							regulator-max-microvolt = <0x1dc130>;
							regulator-min-microvolt = <0xc3500>;
							regulator-name = "vdd_ldo13";
							regulator-ramp-delay = <0x2ee0>;
						};

						LDO14 {
							linux,phandle = <0x54>;
							phandle = <0x54>;
							regulator-initial-mode = <0x3>;
							regulator-max-microvolt = <0x337f98>;
							regulator-min-microvolt = <0x1b7740>;
							regulator-name = "vdd_ldo14";
							regulator-ramp-delay = <0x2ee0>;
						};

						LDO2 {
							linux,phandle = <0x48>;
							phandle = <0x48>;
							regulator-max-microvolt = <0x337f98>;
							regulator-min-microvolt = <0x1b7740>;
							regulator-name = "vqmmc";
							regulator-ramp-delay = <0x2ee0>;
						};

						LDO3 {
							linux,phandle = <0x49>;
							phandle = <0x49>;
							regulator-always-on;
							regulator-initial-mode = <0x3>;
							regulator-max-microvolt = <0x1dc130>;
							regulator-min-microvolt = <0xc3500>;
							regulator-name = "vdd_ldo3";
							regulator-ramp-delay = <0x2ee0>;
						};

						LDO33 {
							linux,phandle = <0x55>;
							phandle = <0x55>;
							regulator-max-microvolt = <0x1dc130>;
							regulator-min-microvolt = <0xc3500>;
							regulator-name = "vdd_ldo33";
							regulator-ramp-delay = <0x2ee0>;
						};

						LDO34 {
							linux,phandle = <0x56>;
							phandle = <0x56>;
							regulator-max-microvolt = <0x337f98>;
							regulator-min-microvolt = <0x1b7740>;
							regulator-name = "vdd_ldo34";
							regulator-ramp-delay = <0x2ee0>;
						};

						LDO35 {
							linux,phandle = <0x57>;
							phandle = <0x57>;
							regulator-max-microvolt = <0x337f98>;
							regulator-min-microvolt = <0x1b7740>;
							regulator-name = "vmmc";
							regulator-ramp-delay = <0x2ee0>;
						};

						LDO36 {
							linux,phandle = <0x58>;
							phandle = <0x58>;
							regulator-always-on;
							regulator-initial-mode = <0x1>;
							regulator-max-microvolt = <0x13d620>;
							regulator-min-microvolt = <0x7a120>;
							regulator-name = "vdd_ldo36";
							regulator-ramp-delay = <0x2ee0>;
						};

						LDO37 {
							linux,phandle = <0x59>;
							phandle = <0x59>;
							regulator-max-microvolt = <0x2ab980>;
							regulator-min-microvolt = <0x2ab980>;
							regulator-name = "vdd_ldo37";
							regulator-ramp-delay = <0x2ee0>;
						};

						LDO38 {
							linux,phandle = <0x5a>;
							phandle = <0x5a>;
							regulator-max-microvolt = <0x325aa0>;
							regulator-min-microvolt = <0x325aa0>;
							regulator-name = "VDD_BTP_3P3";
							regulator-ramp-delay = <0x2ee0>;
						};

						LDO39 {
							linux,phandle = <0x5b>;
							phandle = <0x5b>;
							regulator-initial-mode = <0x3>;
							regulator-max-microvolt = <0x1b7740>;
							regulator-min-microvolt = <0x1b7740>;
							regulator-name = "vdd_ldo39";
						};

						LDO4 {
							linux,phandle = <0x4a>;
							phandle = <0x4a>;
							regulator-always-on;
							regulator-initial-mode = <0x1>;
							regulator-max-microvolt = <0x10c8e0>;
							regulator-min-microvolt = <0x7a120>;
							regulator-name = "vdd_ldo4";
							regulator-ramp-delay = <0x2ee0>;
						};

						LDO40 {
							linux,phandle = <0x8>;
							phandle = <0x8>;
							regulator-boot-on;
							regulator-initial-mode = <0x3>;
							regulator-max-microvolt = <0x325aa0>;
							regulator-min-microvolt = <0x325aa0>;
							regulator-name = "regulator_3v3";
						};

						LDO41 {
							linux,phandle = <0x5c>;
							phandle = <0x5c>;
							regulator-max-microvolt = <0x337f98>;
							regulator-min-microvolt = <0x1b7740>;
							regulator-name = "vdd_ldo41";
							regulator-ramp-delay = <0x2ee0>;
						};

						LDO42 {
							linux,phandle = <0x7>;
							phandle = <0x7>;
							regulator-boot-on;
							regulator-initial-mode = <0x3>;
							regulator-max-microvolt = <0x1b7740>;
							regulator-min-microvolt = <0x1b7740>;
							regulator-name = "regulator_1v8";
							regulator-ramp-delay = <0x2ee0>;
						};

						LDO43 {
							linux,phandle = <0x5d>;
							phandle = <0x5d>;
							regulator-always-on;
							regulator-initial-mode = <0x1>;
							regulator-max-microvolt = <0x13d620>;
							regulator-min-microvolt = <0x7a120>;
							regulator-name = "vdd_ldo43";
							regulator-ramp-delay = <0x2ee0>;
						};

						LDO44 {
							linux,phandle = <0x5e>;
							phandle = <0x5e>;
							regulator-max-microvolt = <0x124f80>;
							regulator-min-microvolt = <0x124f80>;
							regulator-name = "vdd_ldo44";
							regulator-ramp-delay = <0x2ee0>;
						};

						LDO5 {
							linux,phandle = <0x4b>;
							phandle = <0x4b>;
							regulator-always-on;
							regulator-initial-mode = <0x1>;
							regulator-max-microvolt = <0x13d620>;
							regulator-min-microvolt = <0xc3500>;
							regulator-name = "vdd_ldo5";
							regulator-ramp-delay = <0x2ee0>;
						};

						LDO6 {
							linux,phandle = <0x4c>;
							phandle = <0x4c>;
							regulator-always-on;
							regulator-initial-mode = <0x1>;
							regulator-max-microvolt = <0x13d620>;
							regulator-min-microvolt = <0xc3500>;
							regulator-name = "vdd_ldo6";
							regulator-ramp-delay = <0x2ee0>;
						};

						LDO7 {
							linux,phandle = <0x4d>;
							phandle = <0x4d>;
							regulator-always-on;
							regulator-initial-mode = <0x1>;
							regulator-max-microvolt = <0x1dc130>;
							regulator-min-microvolt = <0xc3500>;
							regulator-name = "vdd_ldo7";
							regulator-ramp-delay = <0x2ee0>;
						};

						LDO8 {
							linux,phandle = <0x4e>;
							phandle = <0x4e>;
							regulator-always-on;
							regulator-initial-mode = <0x1>;
							regulator-max-microvolt = <0x13d620>;
							regulator-min-microvolt = <0x7a120>;
							regulator-name = "vdd_ldo8";
							regulator-ramp-delay = <0x2ee0>;
						};

						LDO9 {
							linux,phandle = <0x4f>;
							phandle = <0x4f>;
							regulator-always-on;
							regulator-initial-mode = <0x1>;
							regulator-max-microvolt = <0x13d620>;
							regulator-min-microvolt = <0x7a120>;
							regulator-name = "vdd_ldo9";
							regulator-ramp-delay = <0x2ee0>;
						};
					};
				};
			};

			tsp_ldo_en {
				compatible = "regulator-fixed";
				enable-active-high;
				gpio = <0xffffffff 0x1 0x0>;
				regulator-boot-on;
				regulator-max-microvolt = <0x2dc6c0>;
				regulator-min-microvolt = <0x2dc6c0>;
				regulator-name = "tsp_ldo_en";
			};

			ufs-srpmb {
				compatible = "samsung,ufs-srpmb";
				interrupts = <0x0 0x1cc 0x0>;
			};

			usb3_hs_tune {
				hs_tune_cnt = <0xa>;
				linux,phandle = <0x17>;
				phandle = <0x17>;

				hs_tune1 {
					tune_name = "tx_pre_emp";
					tune_value = <0x3 0x3>;
				};

				hs_tune10 {
					tune_name = "utim_clk";
					tune_value = <0x1 0x1>;
				};

				hs_tune2 {
					tune_name = "tx_pre_emp_plus";
					tune_value = <0x0 0x0>;
				};

				hs_tune3 {
					tune_name = "tx_vref";
					tune_value = <0x7 0x7>;
				};

				hs_tune4 {
					tune_name = "rx_sqrx";
					tune_value = <0x7 0x7>;
				};

				hs_tune5 {
					tune_name = "tx_rise";
					tune_value = <0x3 0x3>;
				};

				hs_tune6 {
					tune_name = "compdis";
					tune_value = <0x7 0x7>;
				};

				hs_tune7 {
					tune_name = "tx_hsxv";
					tune_value = <0x3 0x3>;
				};

				hs_tune8 {
					tune_name = "tx_fsls";
					tune_value = <0x3 0x3>;
				};

				hs_tune9 {
					tune_name = "tx_res";
					tune_value = <0x3 0x3>;
				};
			};

			usb3_ss_tune {
				linux,phandle = <0x18>;
				phandle = <0x18>;
				ss_tune_cnt = <0xf>;

				ss_tune1 {
					tune_name = "tx0_term_offset";
					tune_value = <0x0 0x0>;
				};

				ss_tune10 {
					tune_name = "tx_eye_height_cntl_en";
					tune_value = <0x1 0x1>;
				};

				ss_tune11 {
					tune_name = "pipe_tx_deemph_update_delay";
					tune_value = <0x2 0x2>;
				};

				ss_tune12 {
					tune_name = "pcs_tx_swing_full_sstx";
					tune_value = <0x7f 0x7f>;
				};

				ss_tune13 {
					tune_name = "rx_eq_fix_val";
					tune_value = <0x2 0x2>;
				};

				ss_tune14 {
					tune_name = "rx_decode_mode";
					tune_value = <0x1 0x1>;
				};

				ss_tune15 {
					tune_name = "decrese_ss_tx_imp";
					tune_value = <0x1 0x1>;
				};

				ss_tune2 {
					tune_name = "pcs_tx_swing_full";
					tune_value = <0x7f 0x7f>;
				};

				ss_tune3 {
					tune_name = "pcs_tx_deemph_6db";
					tune_value = <0x1c 0x1c>;
				};

				ss_tune4 {
					tune_name = "pcs_tx_deemph_3p5db";
					tune_value = <0x1c 0x1c>;
				};

				ss_tune5 {
					tune_name = "tx_vboost_lvl_sstx";
					tune_value = <0x7 0x7>;
				};

				ss_tune6 {
					tune_name = "tx_vboost_lvl";
					tune_value = <0x4 0x4>;
				};

				ss_tune7 {
					tune_name = "los_level";
					tune_value = <0x9 0x9>;
				};

				ss_tune8 {
					tune_name = "los_bias";
					tune_value = <0x5 0x5>;
				};

				ss_tune9 {
					tune_name = "pcs_rx_los_mask_val";
					tune_value = <0x104 0x104>;
				};
			};

			usb_hs_tune {
				hs_tune_cnt = <0xc>;
				linux,phandle = <0x16>;
				phandle = <0x16>;

				hs_tune1 {
					tune_name = "tx_vref";
					tune_value = <0xf 0xa>;
				};

				hs_tune10 {
					tune_name = "otg";
					tune_value = <0x2 0x2>;
				};

				hs_tune11 {
					tune_name = "enable_user_imp";
					tune_value = <0x0 0x0>;
				};

				hs_tune12 {
					tune_name = "is_phyclock";
					tune_value = <0x1 0x1>;
				};

				hs_tune2 {
					tune_name = "tx_pre_emp";
					tune_value = <0x3 0x3>;
				};

				hs_tune3 {
					tune_name = "tx_pre_emp_plus";
					tune_value = <0x0 0x0>;
				};

				hs_tune4 {
					tune_name = "tx_res";
					tune_value = <0x3 0x3>;
				};

				hs_tune5 {
					tune_name = "tx_rise";
					tune_value = <0x3 0x3>;
				};

				hs_tune6 {
					tune_name = "tx_hsxv";
					tune_value = <0x3 0x3>;
				};

				hs_tune7 {
					tune_name = "tx_fsls";
					tune_value = <0x3 0x3>;
				};

				hs_tune8 {
					tune_name = "rx_sqrx";
					tune_value = <0x7 0x7>;
				};

				hs_tune9 {
					tune_name = "compdis";
					tune_value = <0x7 0x7>;
				};
			};

			usb_notifier {
				compatible = "samsung,usb-notifier";
				disable_host_wakelock;
				udc = <0xffffffff>;
			};
		};
	};

	fragment@modemif {
		target-path = [2f 00];

		__overlay__ {
			#address-cells = <0x2>;
			#size-cells = <0x1>;

			mif_pdata {
				compatible = "sec_modem,modem_pdata";
				interrupts = <0x0 0x4b 0x0>;
				mbx_ap2cp_kerneltime = <0x9>;
				mbx_ap2cp_mif_value = <0x4>;
				mbx_ap2cp_msg = <0x0>;
				mbx_ap2cp_united_status = <0x2>;
				mbx_cp2ap_dvfsreq = <0x4>;
				mbx_cp2ap_dvfsreq_cpu = <0x5>;
				mbx_cp2ap_dvfsreq_int = <0x7>;
				mbx_cp2ap_dvfsreq_mif = <0x6>;
				mbx_cp2ap_msg = <0x1>;
				mbx_cp2ap_pcie_l1ss_disable = <0x11>;
				mbx_cp2ap_united_status = <0x3>;
				mif,int_ap2cp_active = <0x3>;
				mif,int_ap2cp_msg = <0x0>;
				mif,int_ap2cp_status = <0x2>;
				mif,int_ap2cp_uart_noti = <0xf>;
				mif,int_ap2cp_wakeup = <0x1>;
				mif,ipc_version = <0x32>;
				mif,irq_cp2ap_active = <0x3>;
				mif,irq_cp2ap_msg = <0x0>;
				mif,irq_cp2ap_pcie_l1ss_disable = <0x9>;
				mif,irq_cp2ap_perf_req_cpu = <0x5>;
				mif,irq_cp2ap_perf_req_int = <0x7>;
				mif,irq_cp2ap_perf_req_mif = <0x6>;
				mif,irq_cp2ap_status = <0x2>;
				mif,irq_cp2ap_wakelock = <0x8>;
				mif,link_attrs = <0x7c9>;
				mif,link_name = "shmem";
				mif,link_types = <0x200>;
				mif,modem_net = <0x0>;
				mif,modem_type = <0xa>;
				mif,name = "s337ap";
				mif,num_iodevs = <0x16>;
				mif,use_handover = <0x0>;
				mif,use_usb_phy = <0x0>;
				reg = <0x0 0x10000 0x0>;
				sbi_ap2cp_kerneltime_sec_mask = <0xfff>;
				sbi_ap2cp_kerneltime_sec_pos = <0x14>;
				sbi_ap2cp_kerneltime_usec_mask = <0xfffff>;
				sbi_ap2cp_kerneltime_usec_pos = <0x0>;
				sbi_ap_status_mask = <0xf>;
				sbi_ap_status_pos = <0x1>;
				sbi_cp2ap_wakelock_mask = <0x1>;
				sbi_cp2ap_wakelock_pos = <0x6>;
				sbi_cp_evs_mode_mask = <0x1>;
				sbi_cp_evs_mode_pos = <0x7>;
				sbi_cp_rat_mode_mask = <0x3f>;
				sbi_cp_rat_mode_pos = <0x1a>;
				sbi_cp_status_mask = <0xf>;
				sbi_cp_status_pos = <0x1>;
				sbi_crash_type_mask = <0xf>;
				sbi_crash_type_pos = <0x19>;
				sbi_device_type_mask = <0x1f>;
				sbi_device_type_pos = <0x14>;
				sbi_ds_det_mask = <0x3>;
				sbi_ds_det_pos = <0xe>;
				sbi_ext_backtrace_mask = <0x1>;
				sbi_ext_backtrace_pos = <0x11>;
				sbi_lockval_cp2ap_dvfsreq_endian_mask = <0x1>;
				sbi_lockval_cp2ap_dvfsreq_endian_pos = <0x1f>;
				sbi_lockval_cp2ap_dvfsreq_index_mask = <0x7fff>;
				sbi_lockval_cp2ap_dvfsreq_index_pos = <0x0>;
				sbi_lte_active_mask = <0x1>;
				sbi_lte_active_pos = <0x5>;
				sbi_pda_active_mask = <0x1>;
				sbi_pda_active_pos = <0x5>;
				sbi_sys_rev_mask = <0xff>;
				sbi_sys_rev_pos = <0x6>;
				sbi_uart_noti_mask = <0x1>;
				sbi_uart_noti_pos = <0x10>;
				status = "okay";

				iodevs {

					io_device_0 {
						iod,attrs = <0x82>;
						iod,dl_buffer_size = <0x800>;
						iod,dl_num_buffers = <0x10>;
						iod,format = <0x1>;
						iod,id = <0x23>;
						iod,io_type = <0x0>;
						iod,links = <0x200>;
						iod,max_tx_size = <0x800>;
						iod,name = "umts_cass";
						iod,ul_buffer_size = <0x800>;
						iod,ul_num_buffers = <0x10>;
					};

					io_device_1 {
						iod,app = "RIL";
						iod,attrs = <0x82>;
						iod,dl_buffer_size = <0x1000>;
						iod,dl_num_buffers = <0x20>;
						iod,format = <0x0>;
						iod,id = <0xeb>;
						iod,io_type = <0x0>;
						iod,links = <0x200>;
						iod,name = "umts_ipc0";
						iod,ul_buffer_size = <0x1000>;
						iod,ul_num_buffers = <0x10>;
					};

					io_device_10 {
						iod,app = "NET";
						iod,attrs = <0x180>;
						iod,dl_buffer_size = <0x800>;
						iod,dl_num_buffers = <0x0>;
						iod,format = <0x1>;
						iod,id = <0xd>;
						iod,io_type = <0x1>;
						iod,links = <0x200>;
						iod,name = "rmnet3";
						iod,ul_buffer_size = <0x800>;
						iod,ul_num_buffers = <0x0>;
					};

					io_device_11 {
						iod,attrs = <0x180>;
						iod,dl_buffer_size = <0x800>;
						iod,dl_num_buffers = <0x0>;
						iod,format = <0x1>;
						iod,id = <0xe>;
						iod,io_type = <0x1>;
						iod,links = <0x200>;
						iod,name = "rmnet4";
						iod,ul_buffer_size = <0x800>;
						iod,ul_num_buffers = <0x0>;
					};

					io_device_12 {
						iod,attrs = <0x180>;
						iod,dl_buffer_size = <0x800>;
						iod,dl_num_buffers = <0x0>;
						iod,format = <0x1>;
						iod,id = <0xf>;
						iod,io_type = <0x1>;
						iod,links = <0x200>;
						iod,name = "rmnet5";
						iod,ul_buffer_size = <0x800>;
						iod,ul_num_buffers = <0x0>;
					};

					io_device_13 {
						iod,attrs = <0x180>;
						iod,dl_buffer_size = <0x800>;
						iod,dl_num_buffers = <0x0>;
						iod,format = <0x1>;
						iod,id = <0x10>;
						iod,io_type = <0x1>;
						iod,links = <0x200>;
						iod,name = "rmnet6";
						iod,ul_buffer_size = <0x800>;
						iod,ul_num_buffers = <0x0>;
					};

					io_device_14 {
						iod,attrs = <0x180>;
						iod,dl_buffer_size = <0x800>;
						iod,dl_num_buffers = <0x0>;
						iod,format = <0x1>;
						iod,id = <0x11>;
						iod,io_type = <0x1>;
						iod,links = <0x200>;
						iod,name = "rmnet7";
						iod,ul_buffer_size = <0x800>;
						iod,ul_num_buffers = <0x0>;
					};

					io_device_15 {
						iod,app = "RIL";
						iod,attrs = <0x180>;
						iod,dl_buffer_size = <0x800>;
						iod,dl_num_buffers = <0x100>;
						iod,format = <0x3>;
						iod,id = <0x0>;
						iod,io_type = <0x2>;
						iod,links = <0x200>;
						iod,name = "multipdp_hiprio";
						iod,ul_buffer_size = <0x800>;
						iod,ul_num_buffers = <0x100>;
					};

					io_device_16 {
						iod,app = "RIL";
						iod,attrs = <0x180>;
						iod,dl_buffer_size = <0x800>;
						iod,dl_num_buffers = <0x400>;
						iod,format = <0x3>;
						iod,id = <0x0>;
						iod,io_type = <0x2>;
						iod,links = <0x200>;
						iod,name = "multipdp";
						iod,ul_buffer_size = <0x800>;
						iod,ul_num_buffers = <0x200>;
					};

					io_device_17 {
						iod,app = "CBD";
						iod,attrs = <0x2>;
						iod,format = <0x4>;
						iod,id = <0xd7>;
						iod,io_type = <0x0>;
						iod,links = <0x200>;
						iod,name = "umts_boot0";
					};

					io_device_18 {
						iod,app = "CBD";
						iod,attrs = <0x202>;
						iod,format = <0x5>;
						iod,id = <0xe1>;
						iod,io_type = <0x0>;
						iod,links = <0x200>;
						iod,name = "umts_ramdump0";
					};

					io_device_19 {
						iod,app = "VCD";
						iod,attrs = <0x882>;
						iod,dl_buffer_size = <0x800>;
						iod,dl_num_buffers = <0x80>;
						iod,format = <0x1>;
						iod,id = <0x20>;
						iod,io_type = <0x0>;
						iod,links = <0x200>;
						iod,max_tx_size = <0x800>;
						iod,name = "umts_atc0";
						iod,option_region = "usa_vzw";
						iod,ul_buffer_size = <0x800>;
						iod,ul_num_buffers = <0x10>;
					};

					io_device_2 {
						iod,app = "RIL";
						iod,attrs = <0x82>;
						iod,dl_buffer_size = <0x1000>;
						iod,dl_num_buffers = <0x20>;
						iod,format = <0x0>;
						iod,id = <0xec>;
						iod,io_type = <0x0>;
						iod,links = <0x200>;
						iod,name = "umts_ipc1";
						iod,ul_buffer_size = <0x1000>;
						iod,ul_num_buffers = <0x10>;
					};

					io_device_20 {
						iod,attrs = <0x882>;
						iod,dl_buffer_size = <0x800>;
						iod,dl_num_buffers = <0x80>;
						iod,format = <0x1>;
						iod,id = <0x22>;
						iod,io_type = <0x0>;
						iod,links = <0x200>;
						iod,name = "smd4";
						iod,option_region = "usa_";
						iod,ul_buffer_size = <0x800>;
						iod,ul_num_buffers = <0x10>;
					};

					io_device_21 {
						iod,attrs = <0x882>;
						iod,dl_buffer_size = <0x800>;
						iod,dl_num_buffers = <0x80>;
						iod,format = <0x1>;
						iod,id = <0x1a>;
						iod,io_type = <0x0>;
						iod,links = <0x200>;
						iod,name = "umts_ciq0";
						iod,option_region = "usa_";
						iod,ul_buffer_size = <0x800>;
						iod,ul_num_buffers = <0x10>;
					};

					io_device_3 {
						iod,app = "RFS";
						iod,attrs = <0x82>;
						iod,dl_buffer_size = <0x800>;
						iod,dl_num_buffers = <0x200>;
						iod,format = <0x2>;
						iod,id = <0xf5>;
						iod,io_type = <0x0>;
						iod,links = <0x200>;
						iod,name = "umts_rfs0";
						iod,ul_buffer_size = <0x800>;
						iod,ul_num_buffers = <0x10>;
					};

					io_device_4 {
						iod,app = "CSVT";
						iod,attrs = <0x82>;
						iod,dl_buffer_size = <0x800>;
						iod,dl_num_buffers = <0x40>;
						iod,format = <0x1>;
						iod,id = <0x1>;
						iod,io_type = <0x0>;
						iod,links = <0x200>;
						iod,name = "umts_csd";
						iod,ul_buffer_size = <0x800>;
						iod,ul_num_buffers = <0x20>;
					};

					io_device_5 {
						iod,app = "Data Router";
						iod,attrs = <0x82>;
						iod,dl_buffer_size = <0x800>;
						iod,dl_num_buffers = <0x10>;
						iod,format = <0x1>;
						iod,id = <0x19>;
						iod,io_type = <0x0>;
						iod,links = <0x200>;
						iod,max_tx_size = <0x60e>;
						iod,name = "umts_router";
						iod,ul_buffer_size = <0x800>;
						iod,ul_num_buffers = <0x10>;
					};

					io_device_6 {
						iod,app = "DIAG";
						iod,attrs = <0x82>;
						iod,dl_buffer_size = <0x800>;
						iod,dl_num_buffers = <0x80>;
						iod,format = <0x1>;
						iod,id = <0x1c>;
						iod,io_type = <0x0>;
						iod,links = <0x200>;
						iod,name = "umts_dm0";
						iod,ul_buffer_size = <0x800>;
						iod,ul_num_buffers = <0x10>;
					};

					io_device_7 {
						iod,app = "NET";
						iod,attrs = <0x180>;
						iod,dl_buffer_size = <0x800>;
						iod,dl_num_buffers = <0x0>;
						iod,format = <0x1>;
						iod,id = <0xa>;
						iod,io_type = <0x1>;
						iod,links = <0x200>;
						iod,name = "rmnet0";
						iod,ul_buffer_size = <0x800>;
						iod,ul_num_buffers = <0x0>;
					};

					io_device_8 {
						iod,app = "NET";
						iod,attrs = <0x180>;
						iod,dl_buffer_size = <0x800>;
						iod,dl_num_buffers = <0x0>;
						iod,format = <0x1>;
						iod,id = <0xb>;
						iod,io_type = <0x1>;
						iod,links = <0x200>;
						iod,name = "rmnet1";
						iod,ul_buffer_size = <0x800>;
						iod,ul_num_buffers = <0x0>;
					};

					io_device_9 {
						iod,app = "NET";
						iod,attrs = <0x180>;
						iod,dl_buffer_size = <0x800>;
						iod,dl_num_buffers = <0x0>;
						iod,format = <0x1>;
						iod,id = <0xc>;
						iod,io_type = <0x1>;
						iod,links = <0x200>;
						iod,name = "rmnet2";
						iod,ul_buffer_size = <0x800>;
						iod,ul_num_buffers = <0x0>;
					};
				};
			};

			shmem@F0000000 {
				compatible = "samsung,exynos-shm_ipc";
				linux,phandle = <0x37>;
				phandle = <0x37>;
				shmem,cp_size = <0x7900000>;
				shmem,ipc_offset = <0x8000000>;
				shmem,ipc_size = <0x800000>;
				shmem,vss_size = <0x700000>;
			};
		};
	};

	fragment@motor {
		target-path = [2f 00];

		__overlay__ {

			dc_vibrator {
				compatible = "samsung,dc_vibrator";
				dc_vib,gpio_en = <0xffffffff 0x1 0x0>;
				dc_vib,motor_type = "COINDC";
				pinctrl-0 = <0x36>;
				pinctrl-names = "default";
				status = "okay";
			};
		};
	};

	fragment@sound {
		target-path = [2f 00];

		__overlay__ {

			audio_codec_dummy {
				compatible = "snd-soc-dummy";
				linux,phandle = <0x3>;
				phandle = <0x3>;
				status = "okay";
			};

			audio_cpu_dummy {
				compatible = "samsung,dummy-cpu";
				linux,phandle = <0x38>;
				phandle = <0x38>;
				status = "okay";
			};

			sound {
				clock-names = "xclkout";
				clocks = <0xffffffff 0x321>;
				compatible = "samsung,exynos9610-audio";
				pinctrl-0 = <0xffffffff>;
				pinctrl-names = "default";
				samsung,aux = <0xffffffff 0xffffffff>;
				samsung,codec = <0xffffffff 0xffffffff 0xffffffff 0xffffffff 0xffffffff 0xffffffff 0xffffffff>;
				samsung,prefix = "ABOX", "ABOX", "ABOX", "ABOX", "ABOX", "ABOX", "ABOX";
				samsung,routing = "HEADSETMIC", "MICBIAS1", "MAINMIC", "MICBIAS2", "SUBMIC", "MICBIAS3", "IN1P", "HEADSETMIC", "IN1N", "HEADSETMIC", "IN3P", "MAINMIC", "IN3N", "MAINMIC", "IN4P", "SUBMIC", "IN4N", "SUBMIC", "RECEIVER", "MONOOUT", "RECEIVER", "MONOOUT", "HEADPHONE", "HPOL", "HEADPHONE", "HPOR", "VOUTPUT", "ABOX UAIF0 Playback", "SPEAKER", "ABOX UAIF2 Playback", "VOUTPUTCALL", "ABOX SIFS0 Playback", "BLUETOOTH SPK", "ABOX SIFS2 Playback", "ABOX SPDY Capture", "FM IN", "ABOX SIFS2 Capture", "BLUETOOTH MIC", "ABOX SIFS0 Capture", "VINPUTCALL";
				status = "okay";

				dsif@0 {
					format = "pdm";

					codec {
						sound-dai = <0x3>;
					};

					cpu {
						sound-dai = <0xffffffff>;
					};
				};

				rdma@0 {

					codec {
						sound-dai = <0x3>;
					};

					cpu {
						sound-dai = <0xffffffff 0x0>;
					};

					platform {
						sound-dai = <0xffffffff>;
					};
				};

				rdma@1 {

					codec {
						sound-dai = <0x3>;
					};

					cpu {
						sound-dai = <0xffffffff 0x1>;
					};

					platform {
						sound-dai = <0xffffffff>;
					};
				};

				rdma@2 {

					codec {
						sound-dai = <0x3>;
					};

					cpu {
						sound-dai = <0xffffffff 0x2>;
					};

					platform {
						sound-dai = <0xffffffff>;
					};
				};

				rdma@3 {

					codec {
						sound-dai = <0x3>;
					};

					cpu {
						sound-dai = <0xffffffff 0x3>;
					};

					platform {
						sound-dai = <0xffffffff>;
					};
				};

				rdma@4 {

					codec {
						sound-dai = <0x3>;
					};

					cpu {
						sound-dai = <0xffffffff 0x4>;
					};

					platform {
						sound-dai = <0xffffffff>;
					};
				};

				rdma@5 {

					codec {
						sound-dai = <0x3>;
					};

					cpu {
						sound-dai = <0xffffffff 0x5>;
					};

					platform {
						sound-dai = <0xffffffff>;
					};
				};

				rdma@6 {

					codec {
						sound-dai = <0x3>;
					};

					cpu {
						sound-dai = <0xffffffff 0x6>;
					};

					platform {
						sound-dai = <0xffffffff>;
					};
				};

				rdma@7 {

					codec {
						sound-dai = <0x3>;
					};

					cpu {
						sound-dai = <0xffffffff 0x7>;
					};

					platform {
						sound-dai = <0xffffffff>;
					};
				};

				sifs0@0 {

					codec {
						sound-dai = <0x3>;
					};

					cpu {
						sound-dai = <0xffffffff 0xd>;
					};
				};

				sifs1@0 {

					codec {
						sound-dai = <0x3>;
					};

					cpu {
						sound-dai = <0xffffffff 0xe>;
					};
				};

				sifs2@0 {

					codec {
						sound-dai = <0x3>;
					};

					cpu {
						sound-dai = <0xffffffff 0xf>;
					};
				};

				spdy@0 {

					codec {
						sound-dai = <0x3>;
					};

					cpu {
						sound-dai = <0xffffffff>;
					};
				};

				uaif@0 {
					format = "i2s";

					codec {
						sound-dai = <0x4 0x0>;
					};

					cpu {
						sound-dai = <0xffffffff>;
					};
				};

				uaif@1 {
					format = "i2s";

					codec {
						sound-dai = <0x3>;
					};

					cpu {
						sound-dai = <0xffffffff>;
					};
				};

				uaif@2 {
					format = "i2s";

					codec {
						sound-dai = <0x5 0x0>;
					};

					cpu {
						sound-dai = <0xffffffff>;
					};

					platform {
						sound-dai = <0xffffffff 0x0>;
					};
				};

				uaif@4 {
					bitclock-master;
					format = "i2s";
					frame-master;

					codec {
						sound-dai = <0x3>;
					};

					cpu {
						sound-dai = <0xffffffff>;
					};
				};

				wdma@0 {

					codec {
						sound-dai = <0x3>;
					};

					cpu {
						sound-dai = <0xffffffff 0x8>;
					};

					platform {
						sound-dai = <0xffffffff>;
					};
				};

				wdma@1 {

					codec {
						sound-dai = <0x3>;
					};

					cpu {
						sound-dai = <0xffffffff 0x9>;
					};

					platform {
						sound-dai = <0xffffffff>;
					};
				};

				wdma@2 {

					codec {
						sound-dai = <0x3>;
					};

					cpu {
						sound-dai = <0xffffffff 0xa>;
					};

					platform {
						sound-dai = <0xffffffff>;
					};
				};

				wdma@3 {

					codec {
						sound-dai = <0x3>;
					};

					cpu {
						sound-dai = <0xffffffff 0xb>;
					};

					platform {
						sound-dai = <0xffffffff>;
					};
				};

				wdma@4 {

					codec {
						sound-dai = <0x3>;
					};

					cpu {
						sound-dai = <0xffffffff 0xc>;
					};

					platform {
						sound-dai = <0xffffffff>;
					};
				};
			};
		};
	};
};
